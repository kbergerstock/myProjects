; Listing generated by Microsoft (R) Optimizing Compiler Version 19.29.30133.0 

include listing.inc

INCLUDELIB MSVCRT
INCLUDELIB OLDNAMES

CONST	SEGMENT
?_Fake_alloc@std@@3U_Fake_allocator@1@B	ORG $+1		; std::_Fake_alloc
CONST	ENDS
PUBLIC	??0exception@std@@QEAA@AEBV01@@Z		; std::exception::exception
PUBLIC	??1exception@std@@UEAA@XZ			; std::exception::~exception
PUBLIC	?what@exception@std@@UEBAPEBDXZ			; std::exception::what
PUBLIC	??_Gexception@std@@UEAAPEAXI@Z			; std::exception::`scalar deleting destructor'
PUBLIC	??0bad_alloc@std@@QEAA@AEBV01@@Z		; std::bad_alloc::bad_alloc
PUBLIC	??_Gbad_alloc@std@@UEAAPEAXI@Z			; std::bad_alloc::`scalar deleting destructor'
PUBLIC	??0bad_array_new_length@std@@QEAA@XZ		; std::bad_array_new_length::bad_array_new_length
PUBLIC	??1bad_array_new_length@std@@UEAA@XZ		; std::bad_array_new_length::~bad_array_new_length
PUBLIC	??0bad_array_new_length@std@@QEAA@AEBV01@@Z	; std::bad_array_new_length::bad_array_new_length
PUBLIC	??_Gbad_array_new_length@std@@UEAAPEAXI@Z	; std::bad_array_new_length::`scalar deleting destructor'
PUBLIC	?_Throw_bad_array_new_length@std@@YAXXZ		; std::_Throw_bad_array_new_length
PUBLIC	?_Xlen_string@std@@YAXXZ			; std::_Xlen_string
PUBLIC	??1?$basic_string@DU?$char_traits@D@std@@V?$allocator@D@2@@std@@QEAA@XZ ; std::basic_string<char,std::char_traits<char>,std::allocator<char> >::~basic_string<char,std::char_traits<char>,std::allocator<char> >
PUBLIC	?assign@?$basic_string@DU?$char_traits@D@std@@V?$allocator@D@2@@std@@QEAAAEAV12@QEBD_K@Z ; std::basic_string<char,std::char_traits<char>,std::allocator<char> >::assign
PUBLIC	?_Maklocwcs@std@@YAPEA_WPEB_W@Z			; std::_Maklocwcs
PUBLIC	?dec@std@@YAAEAVios_base@1@AEAV21@@Z		; std::dec
PUBLIC	??1Sieve@@QEAA@XZ				; Sieve::~Sieve
PUBLIC	??$_Getvals@_W@?$time_get@DV?$istreambuf_iterator@DU?$char_traits@D@std@@@std@@@std@@IEAAX_WAEBV_Locinfo@1@@Z ; std::time_get<char,std::istreambuf_iterator<char,std::char_traits<char> > >::_Getvals<wchar_t>
PUBLIC	??$_Getvals@_W@?$time_get@_WV?$istreambuf_iterator@_WU?$char_traits@_W@std@@@std@@@std@@IEAAX_WAEBV_Locinfo@1@@Z ; std::time_get<wchar_t,std::istreambuf_iterator<wchar_t,std::char_traits<wchar_t> > >::_Getvals<wchar_t>
PUBLIC	?time_sieve@@YAXII_N@Z				; time_sieve
PUBLIC	??$?6U?$char_traits@D@std@@@std@@YAAEAV?$basic_ostream@DU?$char_traits@D@std@@@0@AEAV10@PEBD@Z ; std::operator<<<std::char_traits<char> >
PUBLIC	??$endl@DU?$char_traits@D@std@@@std@@YAAEAV?$basic_ostream@DU?$char_traits@D@std@@@0@AEAV10@@Z ; std::endl<char,std::char_traits<char> >
PUBLIC	main
PUBLIC	??1_Sentry_base@?$basic_ostream@DU?$char_traits@D@std@@@std@@QEAA@XZ ; std::basic_ostream<char,std::char_traits<char> >::_Sentry_base::~_Sentry_base
PUBLIC	??1sentry@?$basic_ostream@DU?$char_traits@D@std@@@std@@QEAA@XZ ; std::basic_ostream<char,std::char_traits<char> >::sentry::~sentry
PUBLIC	??$_Maklocstr@D@std@@YAPEADPEBDPEADAEBU_Cvtvec@@@Z ; std::_Maklocstr<char>
PUBLIC	??$_Allocate_manually_vector_aligned@U_Default_allocate_traits@std@@@std@@YAPEAX_K@Z ; std::_Allocate_manually_vector_aligned<std::_Default_allocate_traits>
PUBLIC	??_7exception@std@@6B@				; std::exception::`vftable'
PUBLIC	??_C@_0BC@EOODALEL@Unknown?5exception@		; `string'
PUBLIC	??_7bad_alloc@std@@6B@				; std::bad_alloc::`vftable'
PUBLIC	??_7bad_array_new_length@std@@6B@		; std::bad_array_new_length::`vftable'
PUBLIC	??_C@_0BF@KINCDENJ@bad?5array?5new?5length@	; `string'
PUBLIC	_TI3?AVbad_array_new_length@std@@
PUBLIC	_CTA3?AVbad_array_new_length@std@@
PUBLIC	??_R0?AVbad_array_new_length@std@@@8		; std::bad_array_new_length `RTTI Type Descriptor'
PUBLIC	_CT??_R0?AVbad_array_new_length@std@@@8??0bad_array_new_length@std@@QEAA@AEBV01@@Z24
PUBLIC	??_R0?AVbad_alloc@std@@@8			; std::bad_alloc `RTTI Type Descriptor'
PUBLIC	_CT??_R0?AVbad_alloc@std@@@8??0bad_alloc@std@@QEAA@AEBV01@@Z24
PUBLIC	??_R0?AVexception@std@@@8			; std::exception `RTTI Type Descriptor'
PUBLIC	_CT??_R0?AVexception@std@@@8??0exception@std@@QEAA@AEBV01@@Z24
PUBLIC	??_C@_0BA@JFNIOLAK@string?5too?5long@		; `string'
PUBLIC	??_C@_0BH@DPNNDOEK@invalid?5stoul?5argument@	; `string'
PUBLIC	??_C@_0BM@MOLGGFGJ@stoul?5argument?5out?5of?5range@ ; `string'
PUBLIC	??_C@_07OPANBOLF@?5valid?5@			; `string'
PUBLIC	??_C@_07MOAKCJG@?5count?5@			; `string'
PUBLIC	??_C@_07OBLGNFJI@?5limit?5@			; `string'
PUBLIC	??_C@_03KPBANJDJ@?5mS@				; `string'
PUBLIC	??_C@_0L@FJGKFKOH@?5avg?1pass?5@		; `string'
PUBLIC	??_C@_0P@PHNIAHAC@?5elapsed?5time?5@		; `string'
PUBLIC	??_C@_08DBACIOND@passes?3?5@			; `string'
PUBLIC	??_C@_03PHCFDOEB@?9?9t@				; `string'
PUBLIC	??_C@_03EHAIMEJK@?9?9n@				; `string'
PUBLIC	??_R0PEAD@8					; char * `RTTI Type Descriptor'
PUBLIC	??_C@_0BE@CEADDODL@unhandled?5exception@	; `string'
PUBLIC	??_C@_0BI@CFPLBAOH@invalid?5string?5position@	; `string'
PUBLIC	??_C@_1BK@MHIKGOKE@?$AA?3?$AAA?$AAM?$AA?3?$AAa?$AAm?$AA?3?$AAP?$AAM?$AA?3?$AAp?$AAm@ ; `string'
PUBLIC	??_R4exception@std@@6B@				; std::exception::`RTTI Complete Object Locator'
PUBLIC	??_R3exception@std@@8				; std::exception::`RTTI Class Hierarchy Descriptor'
PUBLIC	??_R2exception@std@@8				; std::exception::`RTTI Base Class Array'
PUBLIC	??_R1A@?0A@EA@exception@std@@8			; std::exception::`RTTI Base Class Descriptor at (0,-1,0,64)'
PUBLIC	??_R4bad_alloc@std@@6B@				; std::bad_alloc::`RTTI Complete Object Locator'
PUBLIC	??_R3bad_alloc@std@@8				; std::bad_alloc::`RTTI Class Hierarchy Descriptor'
PUBLIC	??_R2bad_alloc@std@@8				; std::bad_alloc::`RTTI Base Class Array'
PUBLIC	??_R1A@?0A@EA@bad_alloc@std@@8			; std::bad_alloc::`RTTI Base Class Descriptor at (0,-1,0,64)'
PUBLIC	??_R4bad_array_new_length@std@@6B@		; std::bad_array_new_length::`RTTI Complete Object Locator'
PUBLIC	??_R3bad_array_new_length@std@@8		; std::bad_array_new_length::`RTTI Class Hierarchy Descriptor'
PUBLIC	??_R2bad_array_new_length@std@@8		; std::bad_array_new_length::`RTTI Base Class Array'
PUBLIC	??_R1A@?0A@EA@bad_array_new_length@std@@8	; std::bad_array_new_length::`RTTI Base Class Descriptor at (0,-1,0,64)'
EXTRN	??2@YAPEAX_K@Z:PROC				; operator new
EXTRN	??3@YAXPEAX_K@Z:PROC				; operator delete
EXTRN	__std_terminate:PROC
EXTRN	__imp__invalid_parameter_noinfo_noreturn:PROC
EXTRN	__imp_calloc:PROC
EXTRN	__imp__errno:PROC
EXTRN	__imp_strtoul:PROC
EXTRN	?_Xbad_alloc@std@@YAXXZ:PROC			; std::_Xbad_alloc
EXTRN	?_Xinvalid_argument@std@@YAXPEBD@Z:PROC		; std::_Xinvalid_argument
EXTRN	?_Xlength_error@std@@YAXPEBD@Z:PROC		; std::_Xlength_error
EXTRN	?_Xout_of_range@std@@YAXPEBD@Z:PROC		; std::_Xout_of_range
EXTRN	?uncaught_exception@std@@YA_NXZ:PROC		; std::uncaught_exception
EXTRN	__std_exception_copy:PROC
EXTRN	__std_exception_destroy:PROC
EXTRN	??_Eexception@std@@UEAAPEAXI@Z:PROC		; std::exception::`vector deleting destructor'
EXTRN	??_Ebad_alloc@std@@UEAAPEAXI@Z:PROC		; std::bad_alloc::`vector deleting destructor'
EXTRN	??_Ebad_array_new_length@std@@UEAAPEAXI@Z:PROC	; std::bad_array_new_length::`vector deleting destructor'
EXTRN	_Query_perf_counter:PROC
EXTRN	_Query_perf_frequency:PROC
EXTRN	_Mbrtowc:PROC
EXTRN	__imp_?_Getcvt@_Locinfo@std@@QEBA?AU_Cvtvec@@XZ:PROC
EXTRN	__imp_?_W_Getdays@_Locinfo@std@@QEBAPEBGXZ:PROC
EXTRN	__imp_?_W_Getmonths@_Locinfo@std@@QEBAPEBGXZ:PROC
EXTRN	__imp_?sputc@?$basic_streambuf@DU?$char_traits@D@std@@@std@@QEAAHD@Z:PROC
EXTRN	__imp_?sputn@?$basic_streambuf@DU?$char_traits@D@std@@@std@@QEAA_JPEBD_J@Z:PROC
EXTRN	__imp_?setstate@?$basic_ios@DU?$char_traits@D@std@@@std@@QEAAXH_N@Z:PROC
EXTRN	__imp_?widen@?$basic_ios@DU?$char_traits@D@std@@@std@@QEBADD@Z:PROC
EXTRN	__imp_?_Osfx@?$basic_ostream@DU?$char_traits@D@std@@@std@@QEAAXXZ:PROC
EXTRN	__imp_??6?$basic_ostream@DU?$char_traits@D@std@@@std@@QEAAAEAV01@P6AAEAV01@AEAV01@@Z@Z:PROC
EXTRN	__imp_??6?$basic_ostream@DU?$char_traits@D@std@@@std@@QEAAAEAV01@P6AAEAVios_base@1@AEAV21@@Z@Z:PROC
EXTRN	__imp_??6?$basic_ostream@DU?$char_traits@D@std@@@std@@QEAAAEAV01@_N@Z:PROC
EXTRN	__imp_??6?$basic_ostream@DU?$char_traits@D@std@@@std@@QEAAAEAV01@H@Z:PROC
EXTRN	__imp_??6?$basic_ostream@DU?$char_traits@D@std@@@std@@QEAAAEAV01@I@Z:PROC
EXTRN	__imp_??6?$basic_ostream@DU?$char_traits@D@std@@@std@@QEAAAEAV01@N@Z:PROC
EXTRN	__imp_?put@?$basic_ostream@DU?$char_traits@D@std@@@std@@QEAAAEAV12@D@Z:PROC
EXTRN	__imp_?flush@?$basic_ostream@DU?$char_traits@D@std@@@std@@QEAAAEAV12@XZ:PROC
EXTRN	?empty@tBitArray@@QEAAXXZ:PROC			; tBitArray::empty
EXTRN	??0Sieve@@QEAA@XZ:PROC				; Sieve::Sieve
EXTRN	?init@Sieve@@QEAAXI@Z:PROC			; Sieve::init
EXTRN	?empty@Sieve@@QEAAXXZ:PROC			; Sieve::empty
EXTRN	?sieve2@Sieve@@QEAAHXZ:PROC			; Sieve::sieve2
EXTRN	?validate@Sieve@@QEAA_NH@Z:PROC			; Sieve::validate
EXTRN	??6@YAAEAV?$basic_ostream@DU?$char_traits@D@std@@@std@@AEAV01@AEAVSieve@@@Z:PROC ; operator<<
EXTRN	_CxxThrowException:PROC
EXTRN	__CxxFrameHandler4:PROC
EXTRN	memcmp:PROC
EXTRN	memcpy:PROC
EXTRN	memmove:PROC
EXTRN	??_7type_info@@6B@:BYTE				; type_info::`vftable'
EXTRN	__imp_?cout@std@@3V?$basic_ostream@DU?$char_traits@D@std@@@1@A:BYTE
EXTRN	__imp_?cerr@std@@3V?$basic_ostream@DU?$char_traits@D@std@@@1@A:BYTE
EXTRN	_fltused:DWORD
;	COMDAT pdata
pdata	SEGMENT
$pdata$wmemcpy DD imagerel $LN4
	DD	imagerel $LN4+26
	DD	imagerel $unwind$wmemcpy
pdata	ENDS
;	COMDAT pdata
pdata	SEGMENT
$pdata$??0exception@std@@QEAA@AEBV01@@Z DD imagerel $LN5
	DD	imagerel $LN5+50
	DD	imagerel $unwind$??0exception@std@@QEAA@AEBV01@@Z
pdata	ENDS
;	COMDAT pdata
pdata	SEGMENT
$pdata$??_Gexception@std@@UEAAPEAXI@Z DD imagerel $LN9
	DD	imagerel $LN9+66
	DD	imagerel $unwind$??_Gexception@std@@UEAAPEAXI@Z
pdata	ENDS
;	COMDAT pdata
pdata	SEGMENT
$pdata$??0bad_alloc@std@@QEAA@AEBV01@@Z DD imagerel $LN7
	DD	imagerel $LN7+60
	DD	imagerel $unwind$??0bad_alloc@std@@QEAA@AEBV01@@Z
pdata	ENDS
;	COMDAT pdata
pdata	SEGMENT
$pdata$??_Gbad_alloc@std@@UEAAPEAXI@Z DD imagerel $LN12
	DD	imagerel $LN12+66
	DD	imagerel $unwind$??_Gbad_alloc@std@@UEAAPEAXI@Z
pdata	ENDS
;	COMDAT pdata
pdata	SEGMENT
$pdata$??0bad_array_new_length@std@@QEAA@AEBV01@@Z DD imagerel $LN10
	DD	imagerel $LN10+60
	DD	imagerel $unwind$??0bad_array_new_length@std@@QEAA@AEBV01@@Z
pdata	ENDS
;	COMDAT pdata
pdata	SEGMENT
$pdata$??_Gbad_array_new_length@std@@UEAAPEAXI@Z DD imagerel $LN15
	DD	imagerel $LN15+66
	DD	imagerel $unwind$??_Gbad_array_new_length@std@@UEAAPEAXI@Z
pdata	ENDS
;	COMDAT pdata
pdata	SEGMENT
$pdata$?_Throw_bad_array_new_length@std@@YAXXZ DD imagerel $LN4
	DD	imagerel $LN4+32
	DD	imagerel $unwind$?_Throw_bad_array_new_length@std@@YAXXZ
pdata	ENDS
;	COMDAT pdata
pdata	SEGMENT
$pdata$?_Adjust_manually_vector_aligned@std@@YAXAEAPEAXAEA_K@Z DD imagerel $LN13
	DD	imagerel $LN13+43
	DD	imagerel $unwind$?_Adjust_manually_vector_aligned@std@@YAXAEAPEAXAEA_K@Z
pdata	ENDS
;	COMDAT pdata
pdata	SEGMENT
$pdata$?copy@?$_Char_traits@DH@std@@SAPEADQEADQEBD_K@Z DD imagerel $LN5
	DD	imagerel $LN5+23
	DD	imagerel $unwind$?copy@?$_Char_traits@DH@std@@SAPEADQEADQEBD_K@Z
pdata	ENDS
;	COMDAT pdata
pdata	SEGMENT
$pdata$?move@?$_Char_traits@DH@std@@SAPEADQEADQEBD_K@Z DD imagerel $LN5
	DD	imagerel $LN5+23
	DD	imagerel $unwind$?move@?$_Char_traits@DH@std@@SAPEADQEADQEBD_K@Z
pdata	ENDS
;	COMDAT pdata
pdata	SEGMENT
$pdata$?_Xlen_string@std@@YAXXZ DD imagerel $LN4
	DD	imagerel $LN4+17
	DD	imagerel $unwind$?_Xlen_string@std@@YAXXZ
pdata	ENDS
;	COMDAT pdata
pdata	SEGMENT
$pdata$?deallocate@?$allocator@D@std@@QEAAXQEAD_K@Z DD imagerel $LN21
	DD	imagerel $LN21+62
	DD	imagerel $unwind$?deallocate@?$allocator@D@std@@QEAAXQEAD_K@Z
pdata	ENDS
;	COMDAT pdata
pdata	SEGMENT
$pdata$?allocate@?$allocator@D@std@@QEAAPEAD_K@Z DD imagerel $LN27
	DD	imagerel $LN27+89
	DD	imagerel $unwind$?allocate@?$allocator@D@std@@QEAAPEAD_K@Z
pdata	ENDS
;	COMDAT pdata
pdata	SEGMENT
$pdata$?_Check_offset@?$_String_val@U?$_Simple_types@D@std@@@std@@QEBAX_K@Z DD imagerel $LN7
	DD	imagerel $LN7+21
	DD	imagerel $unwind$?_Check_offset@?$_String_val@U?$_Simple_types@D@std@@@std@@QEBAX_K@Z
pdata	ENDS
;	COMDAT pdata
pdata	SEGMENT
$pdata$?_Xran@?$_String_val@U?$_Simple_types@D@std@@@std@@SAXXZ DD imagerel $LN4
	DD	imagerel $LN4+17
	DD	imagerel $unwind$?_Xran@?$_String_val@U?$_Simple_types@D@std@@@std@@SAXXZ
pdata	ENDS
;	COMDAT pdata
pdata	SEGMENT
$pdata$??0?$basic_string@DU?$char_traits@D@std@@V?$allocator@D@2@@std@@QEAA@AEBV01@_K1AEBV?$allocator@D@1@@Z DD imagerel $LN33
	DD	imagerel $LN33+81
	DD	imagerel $unwind$??0?$basic_string@DU?$char_traits@D@std@@V?$allocator@D@2@@std@@QEAA@AEBV01@_K1AEBV?$allocator@D@1@@Z
pdata	ENDS
;	COMDAT pdata
pdata	SEGMENT
$pdata$??0?$basic_string@DU?$char_traits@D@std@@V?$allocator@D@2@@std@@QEAA@QEBD@Z DD imagerel $LN20
	DD	imagerel $LN20+56
	DD	imagerel $unwind$??0?$basic_string@DU?$char_traits@D@std@@V?$allocator@D@2@@std@@QEAA@QEBD@Z
pdata	ENDS
;	COMDAT pdata
pdata	SEGMENT
$pdata$??1?$basic_string@DU?$char_traits@D@std@@V?$allocator@D@2@@std@@QEAA@XZ DD imagerel $LN30
	DD	imagerel $LN30+95
	DD	imagerel $unwind$??1?$basic_string@DU?$char_traits@D@std@@V?$allocator@D@2@@std@@QEAA@XZ
pdata	ENDS
;	COMDAT pdata
pdata	SEGMENT
$pdata$?assign@?$basic_string@DU?$char_traits@D@std@@V?$allocator@D@2@@std@@QEAAAEAV12@AEBV12@_K_K@Z DD imagerel $LN20
	DD	imagerel $LN20+54
	DD	imagerel $unwind$?assign@?$basic_string@DU?$char_traits@D@std@@V?$allocator@D@2@@std@@QEAAAEAV12@AEBV12@_K_K@Z
pdata	ENDS
;	COMDAT pdata
pdata	SEGMENT
$pdata$?assign@?$basic_string@DU?$char_traits@D@std@@V?$allocator@D@2@@std@@QEAAAEAV12@QEBD_K@Z DD imagerel $LN79
	DD	imagerel $LN79+91
	DD	imagerel $unwind$?assign@?$basic_string@DU?$char_traits@D@std@@V?$allocator@D@2@@std@@QEAAAEAV12@QEBD_K@Z
pdata	ENDS
;	COMDAT pdata
pdata	SEGMENT
$pdata$0$?assign@?$basic_string@DU?$char_traits@D@std@@V?$allocator@D@2@@std@@QEAAAEAV12@QEBD_K@Z DD imagerel $LN79+91
	DD	imagerel $LN79+308
	DD	imagerel $chain$0$?assign@?$basic_string@DU?$char_traits@D@std@@V?$allocator@D@2@@std@@QEAAAEAV12@QEBD_K@Z
pdata	ENDS
;	COMDAT pdata
pdata	SEGMENT
$pdata$1$?assign@?$basic_string@DU?$char_traits@D@std@@V?$allocator@D@2@@std@@QEAAAEAV12@QEBD_K@Z DD imagerel $LN79+308
	DD	imagerel $LN79+330
	DD	imagerel $chain$1$?assign@?$basic_string@DU?$char_traits@D@std@@V?$allocator@D@2@@std@@QEAAAEAV12@QEBD_K@Z
pdata	ENDS
;	COMDAT pdata
pdata	SEGMENT
$pdata$2$?assign@?$basic_string@DU?$char_traits@D@std@@V?$allocator@D@2@@std@@QEAAAEAV12@QEBD_K@Z DD imagerel $LN79+330
	DD	imagerel $LN79+337
	DD	imagerel $chain$2$?assign@?$basic_string@DU?$char_traits@D@std@@V?$allocator@D@2@@std@@QEAAAEAV12@QEBD_K@Z
pdata	ENDS
;	COMDAT pdata
pdata	SEGMENT
$pdata$3$?assign@?$basic_string@DU?$char_traits@D@std@@V?$allocator@D@2@@std@@QEAAAEAV12@QEBD_K@Z DD imagerel $LN79+337
	DD	imagerel $LN79+343
	DD	imagerel $chain$3$?assign@?$basic_string@DU?$char_traits@D@std@@V?$allocator@D@2@@std@@QEAAAEAV12@QEBD_K@Z
pdata	ENDS
;	COMDAT pdata
pdata	SEGMENT
$pdata$4$?assign@?$basic_string@DU?$char_traits@D@std@@V?$allocator@D@2@@std@@QEAAAEAV12@QEBD_K@Z DD imagerel $LN79+343
	DD	imagerel $LN79+349
	DD	imagerel $chain$4$?assign@?$basic_string@DU?$char_traits@D@std@@V?$allocator@D@2@@std@@QEAAAEAV12@QEBD_K@Z
pdata	ENDS
;	COMDAT pdata
pdata	SEGMENT
$pdata$?substr@?$basic_string@DU?$char_traits@D@std@@V?$allocator@D@2@@std@@QEBA?AV12@_K0@Z DD imagerel $LN38
	DD	imagerel $LN38+87
	DD	imagerel $unwind$?substr@?$basic_string@DU?$char_traits@D@std@@V?$allocator@D@2@@std@@QEBA?AV12@_K0@Z
pdata	ENDS
;	COMDAT pdata
pdata	SEGMENT
$pdata$?_Equal@?$basic_string@DU?$char_traits@D@std@@V?$allocator@D@2@@std@@QEBA_NQEBD@Z DD imagerel $LN19
	DD	imagerel $LN19+73
	DD	imagerel $unwind$?_Equal@?$basic_string@DU?$char_traits@D@std@@V?$allocator@D@2@@std@@QEBA_NQEBD@Z
pdata	ENDS
;	COMDAT pdata
pdata	SEGMENT
$pdata$?_Tidy_deallocate@?$basic_string@DU?$char_traits@D@std@@V?$allocator@D@2@@std@@AEAAXXZ DD imagerel $LN27
	DD	imagerel $LN27+95
	DD	imagerel $unwind$?_Tidy_deallocate@?$basic_string@DU?$char_traits@D@std@@V?$allocator@D@2@@std@@AEAAXXZ
pdata	ENDS
;	COMDAT pdata
pdata	SEGMENT
$pdata$??$_Maklocstr@_W@std@@YAPEA_WPEBDPEA_WAEBU_Cvtvec@@@Z DD imagerel $LN28
	DD	imagerel $LN28+258
	DD	imagerel $unwind$??$_Maklocstr@_W@std@@YAPEA_WPEBDPEA_WAEBU_Cvtvec@@@Z
pdata	ENDS
;	COMDAT pdata
pdata	SEGMENT
$pdata$?_Maklocwcs@std@@YAPEA_WPEB_W@Z DD imagerel $LN10
	DD	imagerel $LN10+107
	DD	imagerel $unwind$?_Maklocwcs@std@@YAPEA_WPEB_W@Z
pdata	ENDS
;	COMDAT pdata
pdata	SEGMENT
$pdata$?now@steady_clock@chrono@std@@SA?AV?$time_point@Usteady_clock@chrono@std@@V?$duration@_JU?$ratio@$00$0DLJKMKAA@@std@@@23@@23@XZ DD imagerel $LN9
	DD	imagerel $LN9+73
	DD	imagerel $unwind$?now@steady_clock@chrono@std@@SA?AV?$time_point@Usteady_clock@chrono@std@@V?$duration@_JU?$ratio@$00$0DLJKMKAA@@std@@@23@@23@XZ
pdata	ENDS
;	COMDAT pdata
pdata	SEGMENT
$pdata$?stoul@std@@YAKAEBV?$basic_string@DU?$char_traits@D@std@@V?$allocator@D@2@@1@PEA_KH@Z DD imagerel $LN18
	DD	imagerel $LN18+144
	DD	imagerel $unwind$?stoul@std@@YAKAEBV?$basic_string@DU?$char_traits@D@std@@V?$allocator@D@2@@1@PEA_KH@Z
pdata	ENDS
;	COMDAT pdata
pdata	SEGMENT
$pdata$??1tBitArray@@QEAA@XZ DD imagerel $LN5
	DD	imagerel $LN5+15
	DD	imagerel $unwind$??1tBitArray@@QEAA@XZ
pdata	ENDS
;	COMDAT pdata
pdata	SEGMENT
$pdata$??1Sieve@@QEAA@XZ DD imagerel $LN8
	DD	imagerel $LN8+19
	DD	imagerel $unwind$??1Sieve@@QEAA@XZ
pdata	ENDS
;	COMDAT pdata
pdata	SEGMENT
$pdata$??$_Getvals@_W@?$time_get@DV?$istreambuf_iterator@DU?$char_traits@D@std@@@std@@@std@@IEAAX_WAEBV_Locinfo@1@@Z DD imagerel $LN20
	DD	imagerel $LN20+180
	DD	imagerel $unwind$??$_Getvals@_W@?$time_get@DV?$istreambuf_iterator@DU?$char_traits@D@std@@@std@@@std@@IEAAX_WAEBV_Locinfo@1@@Z
pdata	ENDS
;	COMDAT pdata
pdata	SEGMENT
$pdata$??$_Getvals@_W@?$time_get@_WV?$istreambuf_iterator@_WU?$char_traits@_W@std@@@std@@@std@@IEAAX_WAEBV_Locinfo@1@@Z DD imagerel $LN14
	DD	imagerel $LN14+180
	DD	imagerel $unwind$??$_Getvals@_W@?$time_get@_WV?$istreambuf_iterator@_WU?$char_traits@_W@std@@@std@@@std@@IEAAX_WAEBV_Locinfo@1@@Z
pdata	ENDS
;	COMDAT pdata
pdata	SEGMENT
$pdata$?time_sieve@@YAXII_N@Z DD imagerel $LN82
	DD	imagerel $LN82+687
	DD	imagerel $unwind$?time_sieve@@YAXII_N@Z
pdata	ENDS
;	COMDAT pdata
pdata	SEGMENT
$pdata$??$?6U?$char_traits@D@std@@@std@@YAAEAV?$basic_ostream@DU?$char_traits@D@std@@@0@AEAV10@PEBD@Z DD imagerel $LN99
	DD	imagerel $LN99+457
	DD	imagerel $unwind$??$?6U?$char_traits@D@std@@@std@@YAAEAV?$basic_ostream@DU?$char_traits@D@std@@@0@AEAV10@PEBD@Z
pdata	ENDS
;	COMDAT pdata
pdata	SEGMENT
$pdata$?catch$4@?0???$?6U?$char_traits@D@std@@@std@@YAAEAV?$basic_ostream@DU?$char_traits@D@std@@@0@AEAV10@PEBD@Z@4HA DD imagerel ?catch$4@?0???$?6U?$char_traits@D@std@@@std@@YAAEAV?$basic_ostream@DU?$char_traits@D@std@@@0@AEAV10@PEBD@Z@4HA
	DD	imagerel ?catch$4@?0???$?6U?$char_traits@D@std@@@std@@YAAEAV?$basic_ostream@DU?$char_traits@D@std@@@0@AEAV10@PEBD@Z@4HA+59
	DD	imagerel $unwind$?catch$4@?0???$?6U?$char_traits@D@std@@@std@@YAAEAV?$basic_ostream@DU?$char_traits@D@std@@@0@AEAV10@PEBD@Z@4HA
pdata	ENDS
;	COMDAT pdata
pdata	SEGMENT
$pdata$??$endl@DU?$char_traits@D@std@@@std@@YAAEAV?$basic_ostream@DU?$char_traits@D@std@@@0@AEAV10@@Z DD imagerel $LN4
	DD	imagerel $LN4+57
	DD	imagerel $unwind$??$endl@DU?$char_traits@D@std@@@std@@YAAEAV?$basic_ostream@DU?$char_traits@D@std@@@0@AEAV10@@Z
pdata	ENDS
;	COMDAT pdata
pdata	SEGMENT
$pdata$main DD	imagerel $LN531
	DD	imagerel $LN531+1656
	DD	imagerel $unwind$main
pdata	ENDS
;	COMDAT pdata
pdata	SEGMENT
$pdata$main$catch$22 DD imagerel main$catch$22
	DD	imagerel main$catch$22+50
	DD	imagerel $unwind$main$catch$22
pdata	ENDS
;	COMDAT pdata
pdata	SEGMENT
$pdata$main$catch$23 DD imagerel main$catch$23
	DD	imagerel main$catch$23+50
	DD	imagerel $unwind$main$catch$23
pdata	ENDS
;	COMDAT pdata
pdata	SEGMENT
$pdata$??$?8DU?$char_traits@D@std@@V?$allocator@D@1@@std@@YA_NAEBV?$basic_string@DU?$char_traits@D@std@@V?$allocator@D@2@@0@QEBD@Z DD imagerel $LN21
	DD	imagerel $LN21+73
	DD	imagerel $unwind$??$?8DU?$char_traits@D@std@@V?$allocator@D@1@@std@@YA_NAEBV?$basic_string@DU?$char_traits@D@std@@V?$allocator@D@2@@0@QEBD@Z
pdata	ENDS
;	COMDAT pdata
pdata	SEGMENT
$pdata$??0_Sentry_base@?$basic_ostream@DU?$char_traits@D@std@@@std@@QEAA@AEAV12@@Z DD imagerel $LN8
	DD	imagerel $LN8+44
	DD	imagerel $unwind$??0_Sentry_base@?$basic_ostream@DU?$char_traits@D@std@@@std@@QEAA@AEAV12@@Z
pdata	ENDS
;	COMDAT pdata
pdata	SEGMENT
$pdata$??1_Sentry_base@?$basic_ostream@DU?$char_traits@D@std@@@std@@QEAA@XZ DD imagerel $LN8
	DD	imagerel $LN8+36
	DD	imagerel $unwind$??1_Sentry_base@?$basic_ostream@DU?$char_traits@D@std@@@std@@QEAA@XZ
pdata	ENDS
;	COMDAT pdata
pdata	SEGMENT
$pdata$??0sentry@?$basic_ostream@DU?$char_traits@D@std@@@std@@QEAA@AEAV12@@Z DD imagerel $LN24
	DD	imagerel $LN24+122
	DD	imagerel $unwind$??0sentry@?$basic_ostream@DU?$char_traits@D@std@@@std@@QEAA@AEAV12@@Z
pdata	ENDS
;	COMDAT pdata
pdata	SEGMENT
$pdata$??1sentry@?$basic_ostream@DU?$char_traits@D@std@@@std@@QEAA@XZ DD imagerel $LN13
	DD	imagerel $LN13+61
	DD	imagerel $unwind$??1sentry@?$basic_ostream@DU?$char_traits@D@std@@@std@@QEAA@XZ
pdata	ENDS
;	COMDAT pdata
pdata	SEGMENT
$pdata$??R<lambda_66f57f934f28d61049862f64df852ff0>@@QEBA@QEAD_KQEBD@Z DD imagerel $LN7
	DD	imagerel $LN7+42
	DD	imagerel $unwind$??R<lambda_66f57f934f28d61049862f64df852ff0>@@QEBA@QEAD_KQEBD@Z
pdata	ENDS
;	COMDAT pdata
pdata	SEGMENT
$pdata$??$_Reallocate_for@V<lambda_66f57f934f28d61049862f64df852ff0>@@PEBD@?$basic_string@DU?$char_traits@D@std@@V?$allocator@D@2@@std@@AEAAAEAV01@_KV<lambda_66f57f934f28d61049862f64df852ff0>@@PEBD@Z DD imagerel $LN68
	DD	imagerel $LN68+41
	DD	imagerel $unwind$??$_Reallocate_for@V<lambda_66f57f934f28d61049862f64df852ff0>@@PEBD@?$basic_string@DU?$char_traits@D@std@@V?$allocator@D@2@@std@@AEAAAEAV01@_KV<lambda_66f57f934f28d61049862f64df852ff0>@@PEBD@Z
pdata	ENDS
;	COMDAT pdata
pdata	SEGMENT
$pdata$1$??$_Reallocate_for@V<lambda_66f57f934f28d61049862f64df852ff0>@@PEBD@?$basic_string@DU?$char_traits@D@std@@V?$allocator@D@2@@std@@AEAAAEAV01@_KV<lambda_66f57f934f28d61049862f64df852ff0>@@PEBD@Z DD imagerel $LN68+41
	DD	imagerel $LN68+290
	DD	imagerel $chain$1$??$_Reallocate_for@V<lambda_66f57f934f28d61049862f64df852ff0>@@PEBD@?$basic_string@DU?$char_traits@D@std@@V?$allocator@D@2@@std@@AEAAAEAV01@_KV<lambda_66f57f934f28d61049862f64df852ff0>@@PEBD@Z
pdata	ENDS
;	COMDAT pdata
pdata	SEGMENT
$pdata$3$??$_Reallocate_for@V<lambda_66f57f934f28d61049862f64df852ff0>@@PEBD@?$basic_string@DU?$char_traits@D@std@@V?$allocator@D@2@@std@@AEAAAEAV01@_KV<lambda_66f57f934f28d61049862f64df852ff0>@@PEBD@Z DD imagerel $LN68+290
	DD	imagerel $LN68+297
	DD	imagerel $chain$3$??$_Reallocate_for@V<lambda_66f57f934f28d61049862f64df852ff0>@@PEBD@?$basic_string@DU?$char_traits@D@std@@V?$allocator@D@2@@std@@AEAAAEAV01@_KV<lambda_66f57f934f28d61049862f64df852ff0>@@PEBD@Z
pdata	ENDS
;	COMDAT pdata
pdata	SEGMENT
$pdata$4$??$_Reallocate_for@V<lambda_66f57f934f28d61049862f64df852ff0>@@PEBD@?$basic_string@DU?$char_traits@D@std@@V?$allocator@D@2@@std@@AEAAAEAV01@_KV<lambda_66f57f934f28d61049862f64df852ff0>@@PEBD@Z DD imagerel $LN68+297
	DD	imagerel $LN68+303
	DD	imagerel $chain$4$??$_Reallocate_for@V<lambda_66f57f934f28d61049862f64df852ff0>@@PEBD@?$basic_string@DU?$char_traits@D@std@@V?$allocator@D@2@@std@@AEAAAEAV01@_KV<lambda_66f57f934f28d61049862f64df852ff0>@@PEBD@Z
pdata	ENDS
;	COMDAT pdata
pdata	SEGMENT
$pdata$5$??$_Reallocate_for@V<lambda_66f57f934f28d61049862f64df852ff0>@@PEBD@?$basic_string@DU?$char_traits@D@std@@V?$allocator@D@2@@std@@AEAAAEAV01@_KV<lambda_66f57f934f28d61049862f64df852ff0>@@PEBD@Z DD imagerel $LN68+303
	DD	imagerel $LN68+309
	DD	imagerel $chain$5$??$_Reallocate_for@V<lambda_66f57f934f28d61049862f64df852ff0>@@PEBD@?$basic_string@DU?$char_traits@D@std@@V?$allocator@D@2@@std@@AEAAAEAV01@_KV<lambda_66f57f934f28d61049862f64df852ff0>@@PEBD@Z
pdata	ENDS
;	COMDAT pdata
pdata	SEGMENT
$pdata$??$_Deallocate@$0BA@$0A@@std@@YAXPEAX_K@Z DD imagerel $LN18
	DD	imagerel $LN18+53
	DD	imagerel $unwind$??$_Deallocate@$0BA@$0A@@std@@YAXPEAX_K@Z
pdata	ENDS
;	COMDAT pdata
pdata	SEGMENT
$pdata$??$_Allocate@$0BA@U_Default_allocate_traits@std@@$0A@@std@@YAPEAX_K@Z DD imagerel $LN24
	DD	imagerel $LN24+89
	DD	imagerel $unwind$??$_Allocate@$0BA@U_Default_allocate_traits@std@@$0A@@std@@YAPEAX_K@Z
pdata	ENDS
;	COMDAT pdata
pdata	SEGMENT
$pdata$??$_Maklocstr@D@std@@YAPEADPEBDPEADAEBU_Cvtvec@@@Z DD imagerel $LN15
	DD	imagerel $LN15+113
	DD	imagerel $unwind$??$_Maklocstr@D@std@@YAPEADPEBDPEADAEBU_Cvtvec@@@Z
pdata	ENDS
;	COMDAT pdata
pdata	SEGMENT
$pdata$??$_Allocate_manually_vector_aligned@U_Default_allocate_traits@std@@@std@@YAPEAX_K@Z DD imagerel $LN17
	DD	imagerel $LN17+59
	DD	imagerel $unwind$??$_Allocate_manually_vector_aligned@U_Default_allocate_traits@std@@@std@@YAPEAX_K@Z
pdata	ENDS
;	COMDAT pdata
pdata	SEGMENT
$pdata$??$_Traits_equal@U?$char_traits@D@std@@@std@@YA_NQEBD_K01@Z DD imagerel $LN9
	DD	imagerel $LN9+41
	DD	imagerel $unwind$??$_Traits_equal@U?$char_traits@D@std@@@std@@YA_NQEBD_K01@Z
pdata	ENDS
;	COMDAT ??_R1A@?0A@EA@bad_array_new_length@std@@8
rdata$r	SEGMENT
??_R1A@?0A@EA@bad_array_new_length@std@@8 DD imagerel ??_R0?AVbad_array_new_length@std@@@8 ; std::bad_array_new_length::`RTTI Base Class Descriptor at (0,-1,0,64)'
	DD	02H
	DD	00H
	DD	0ffffffffH
	DD	00H
	DD	040H
	DD	imagerel ??_R3bad_array_new_length@std@@8
rdata$r	ENDS
;	COMDAT ??_R2bad_array_new_length@std@@8
rdata$r	SEGMENT
??_R2bad_array_new_length@std@@8 DD imagerel ??_R1A@?0A@EA@bad_array_new_length@std@@8 ; std::bad_array_new_length::`RTTI Base Class Array'
	DD	imagerel ??_R1A@?0A@EA@bad_alloc@std@@8
	DD	imagerel ??_R1A@?0A@EA@exception@std@@8
	ORG $+3
rdata$r	ENDS
;	COMDAT ??_R3bad_array_new_length@std@@8
rdata$r	SEGMENT
??_R3bad_array_new_length@std@@8 DD 00H			; std::bad_array_new_length::`RTTI Class Hierarchy Descriptor'
	DD	00H
	DD	03H
	DD	imagerel ??_R2bad_array_new_length@std@@8
rdata$r	ENDS
;	COMDAT ??_R4bad_array_new_length@std@@6B@
rdata$r	SEGMENT
??_R4bad_array_new_length@std@@6B@ DD 01H		; std::bad_array_new_length::`RTTI Complete Object Locator'
	DD	00H
	DD	00H
	DD	imagerel ??_R0?AVbad_array_new_length@std@@@8
	DD	imagerel ??_R3bad_array_new_length@std@@8
	DD	imagerel ??_R4bad_array_new_length@std@@6B@
rdata$r	ENDS
;	COMDAT ??_R1A@?0A@EA@bad_alloc@std@@8
rdata$r	SEGMENT
??_R1A@?0A@EA@bad_alloc@std@@8 DD imagerel ??_R0?AVbad_alloc@std@@@8 ; std::bad_alloc::`RTTI Base Class Descriptor at (0,-1,0,64)'
	DD	01H
	DD	00H
	DD	0ffffffffH
	DD	00H
	DD	040H
	DD	imagerel ??_R3bad_alloc@std@@8
rdata$r	ENDS
;	COMDAT ??_R2bad_alloc@std@@8
rdata$r	SEGMENT
??_R2bad_alloc@std@@8 DD imagerel ??_R1A@?0A@EA@bad_alloc@std@@8 ; std::bad_alloc::`RTTI Base Class Array'
	DD	imagerel ??_R1A@?0A@EA@exception@std@@8
	ORG $+3
rdata$r	ENDS
;	COMDAT ??_R3bad_alloc@std@@8
rdata$r	SEGMENT
??_R3bad_alloc@std@@8 DD 00H				; std::bad_alloc::`RTTI Class Hierarchy Descriptor'
	DD	00H
	DD	02H
	DD	imagerel ??_R2bad_alloc@std@@8
rdata$r	ENDS
;	COMDAT ??_R4bad_alloc@std@@6B@
rdata$r	SEGMENT
??_R4bad_alloc@std@@6B@ DD 01H				; std::bad_alloc::`RTTI Complete Object Locator'
	DD	00H
	DD	00H
	DD	imagerel ??_R0?AVbad_alloc@std@@@8
	DD	imagerel ??_R3bad_alloc@std@@8
	DD	imagerel ??_R4bad_alloc@std@@6B@
rdata$r	ENDS
;	COMDAT ??_R1A@?0A@EA@exception@std@@8
rdata$r	SEGMENT
??_R1A@?0A@EA@exception@std@@8 DD imagerel ??_R0?AVexception@std@@@8 ; std::exception::`RTTI Base Class Descriptor at (0,-1,0,64)'
	DD	00H
	DD	00H
	DD	0ffffffffH
	DD	00H
	DD	040H
	DD	imagerel ??_R3exception@std@@8
rdata$r	ENDS
;	COMDAT ??_R2exception@std@@8
rdata$r	SEGMENT
??_R2exception@std@@8 DD imagerel ??_R1A@?0A@EA@exception@std@@8 ; std::exception::`RTTI Base Class Array'
	ORG $+3
rdata$r	ENDS
;	COMDAT ??_R3exception@std@@8
rdata$r	SEGMENT
??_R3exception@std@@8 DD 00H				; std::exception::`RTTI Class Hierarchy Descriptor'
	DD	00H
	DD	01H
	DD	imagerel ??_R2exception@std@@8
rdata$r	ENDS
;	COMDAT ??_R4exception@std@@6B@
rdata$r	SEGMENT
??_R4exception@std@@6B@ DD 01H				; std::exception::`RTTI Complete Object Locator'
	DD	00H
	DD	00H
	DD	imagerel ??_R0?AVexception@std@@@8
	DD	imagerel ??_R3exception@std@@8
	DD	imagerel ??_R4exception@std@@6B@
rdata$r	ENDS
;	COMDAT ??_C@_1BK@MHIKGOKE@?$AA?3?$AAA?$AAM?$AA?3?$AAa?$AAm?$AA?3?$AAP?$AAM?$AA?3?$AAp?$AAm@
CONST	SEGMENT
??_C@_1BK@MHIKGOKE@?$AA?3?$AAA?$AAM?$AA?3?$AAa?$AAm?$AA?3?$AAP?$AAM?$AA?3?$AAp?$AAm@ DB ':'
	DB	00H, 'A', 00H, 'M', 00H, ':', 00H, 'a', 00H, 'm', 00H, ':', 00H
	DB	'P', 00H, 'M', 00H, ':', 00H, 'p', 00H, 'm', 00H, 00H, 00H ; `string'
CONST	ENDS
;	COMDAT ??_C@_0BI@CFPLBAOH@invalid?5string?5position@
CONST	SEGMENT
??_C@_0BI@CFPLBAOH@invalid?5string?5position@ DB 'invalid string position'
	DB	00H						; `string'
CONST	ENDS
;	COMDAT ??_C@_0BE@CEADDODL@unhandled?5exception@
CONST	SEGMENT
??_C@_0BE@CEADDODL@unhandled?5exception@ DB 'unhandled exception', 00H ; `string'
CONST	ENDS
;	COMDAT ??_R0PEAD@8
data$r	SEGMENT
??_R0PEAD@8 DQ	FLAT:??_7type_info@@6B@			; char * `RTTI Type Descriptor'
	DQ	0000000000000000H
	DB	'.PEAD', 00H
data$r	ENDS
;	COMDAT ??_C@_03EHAIMEJK@?9?9n@
CONST	SEGMENT
??_C@_03EHAIMEJK@?9?9n@ DB '--n', 00H			; `string'
CONST	ENDS
;	COMDAT ??_C@_03PHCFDOEB@?9?9t@
CONST	SEGMENT
??_C@_03PHCFDOEB@?9?9t@ DB '--t', 00H			; `string'
CONST	ENDS
;	COMDAT ??_C@_08DBACIOND@passes?3?5@
CONST	SEGMENT
??_C@_08DBACIOND@passes?3?5@ DB 'passes: ', 00H		; `string'
CONST	ENDS
;	COMDAT ??_C@_0P@PHNIAHAC@?5elapsed?5time?5@
CONST	SEGMENT
??_C@_0P@PHNIAHAC@?5elapsed?5time?5@ DB ' elapsed time ', 00H ; `string'
CONST	ENDS
;	COMDAT ??_C@_0L@FJGKFKOH@?5avg?1pass?5@
CONST	SEGMENT
??_C@_0L@FJGKFKOH@?5avg?1pass?5@ DB ' avg/pass ', 00H	; `string'
CONST	ENDS
;	COMDAT ??_C@_03KPBANJDJ@?5mS@
CONST	SEGMENT
??_C@_03KPBANJDJ@?5mS@ DB ' mS', 00H			; `string'
CONST	ENDS
;	COMDAT ??_C@_07OBLGNFJI@?5limit?5@
CONST	SEGMENT
??_C@_07OBLGNFJI@?5limit?5@ DB ' limit ', 00H		; `string'
CONST	ENDS
;	COMDAT ??_C@_07MOAKCJG@?5count?5@
CONST	SEGMENT
??_C@_07MOAKCJG@?5count?5@ DB ' count ', 00H		; `string'
CONST	ENDS
;	COMDAT ??_C@_07OPANBOLF@?5valid?5@
CONST	SEGMENT
??_C@_07OPANBOLF@?5valid?5@ DB ' valid ', 00H		; `string'
CONST	ENDS
;	COMDAT ??_C@_0BM@MOLGGFGJ@stoul?5argument?5out?5of?5range@
CONST	SEGMENT
??_C@_0BM@MOLGGFGJ@stoul?5argument?5out?5of?5range@ DB 'stoul argument ou'
	DB	't of range', 00H				; `string'
CONST	ENDS
;	COMDAT ??_C@_0BH@DPNNDOEK@invalid?5stoul?5argument@
CONST	SEGMENT
??_C@_0BH@DPNNDOEK@invalid?5stoul?5argument@ DB 'invalid stoul argument', 00H ; `string'
CONST	ENDS
;	COMDAT ??_C@_0BA@JFNIOLAK@string?5too?5long@
CONST	SEGMENT
??_C@_0BA@JFNIOLAK@string?5too?5long@ DB 'string too long', 00H ; `string'
CONST	ENDS
;	COMDAT _CT??_R0?AVexception@std@@@8??0exception@std@@QEAA@AEBV01@@Z24
xdata$x	SEGMENT
_CT??_R0?AVexception@std@@@8??0exception@std@@QEAA@AEBV01@@Z24 DD 00H
	DD	imagerel ??_R0?AVexception@std@@@8
	DD	00H
	DD	0ffffffffH
	ORG $+4
	DD	018H
	DD	imagerel ??0exception@std@@QEAA@AEBV01@@Z
xdata$x	ENDS
;	COMDAT ??_R0?AVexception@std@@@8
data$r	SEGMENT
??_R0?AVexception@std@@@8 DQ FLAT:??_7type_info@@6B@	; std::exception `RTTI Type Descriptor'
	DQ	0000000000000000H
	DB	'.?AVexception@std@@', 00H
data$r	ENDS
;	COMDAT _CT??_R0?AVbad_alloc@std@@@8??0bad_alloc@std@@QEAA@AEBV01@@Z24
xdata$x	SEGMENT
_CT??_R0?AVbad_alloc@std@@@8??0bad_alloc@std@@QEAA@AEBV01@@Z24 DD 010H
	DD	imagerel ??_R0?AVbad_alloc@std@@@8
	DD	00H
	DD	0ffffffffH
	ORG $+4
	DD	018H
	DD	imagerel ??0bad_alloc@std@@QEAA@AEBV01@@Z
xdata$x	ENDS
;	COMDAT ??_R0?AVbad_alloc@std@@@8
data$r	SEGMENT
??_R0?AVbad_alloc@std@@@8 DQ FLAT:??_7type_info@@6B@	; std::bad_alloc `RTTI Type Descriptor'
	DQ	0000000000000000H
	DB	'.?AVbad_alloc@std@@', 00H
data$r	ENDS
;	COMDAT _CT??_R0?AVbad_array_new_length@std@@@8??0bad_array_new_length@std@@QEAA@AEBV01@@Z24
xdata$x	SEGMENT
_CT??_R0?AVbad_array_new_length@std@@@8??0bad_array_new_length@std@@QEAA@AEBV01@@Z24 DD 00H
	DD	imagerel ??_R0?AVbad_array_new_length@std@@@8
	DD	00H
	DD	0ffffffffH
	ORG $+4
	DD	018H
	DD	imagerel ??0bad_array_new_length@std@@QEAA@AEBV01@@Z
xdata$x	ENDS
;	COMDAT ??_R0?AVbad_array_new_length@std@@@8
data$r	SEGMENT
??_R0?AVbad_array_new_length@std@@@8 DQ FLAT:??_7type_info@@6B@ ; std::bad_array_new_length `RTTI Type Descriptor'
	DQ	0000000000000000H
	DB	'.?AVbad_array_new_length@std@@', 00H
data$r	ENDS
;	COMDAT _CTA3?AVbad_array_new_length@std@@
xdata$x	SEGMENT
_CTA3?AVbad_array_new_length@std@@ DD 03H
	DD	imagerel _CT??_R0?AVbad_array_new_length@std@@@8??0bad_array_new_length@std@@QEAA@AEBV01@@Z24
	DD	imagerel _CT??_R0?AVbad_alloc@std@@@8??0bad_alloc@std@@QEAA@AEBV01@@Z24
	DD	imagerel _CT??_R0?AVexception@std@@@8??0exception@std@@QEAA@AEBV01@@Z24
xdata$x	ENDS
;	COMDAT _TI3?AVbad_array_new_length@std@@
xdata$x	SEGMENT
_TI3?AVbad_array_new_length@std@@ DD 00H
	DD	imagerel ??1bad_array_new_length@std@@UEAA@XZ
	DD	00H
	DD	imagerel _CTA3?AVbad_array_new_length@std@@
xdata$x	ENDS
;	COMDAT ??_C@_0BF@KINCDENJ@bad?5array?5new?5length@
CONST	SEGMENT
??_C@_0BF@KINCDENJ@bad?5array?5new?5length@ DB 'bad array new length', 00H ; `string'
CONST	ENDS
;	COMDAT ??_7bad_array_new_length@std@@6B@
CONST	SEGMENT
??_7bad_array_new_length@std@@6B@ DQ FLAT:??_R4bad_array_new_length@std@@6B@ ; std::bad_array_new_length::`vftable'
	DQ	FLAT:??_Ebad_array_new_length@std@@UEAAPEAXI@Z
	DQ	FLAT:?what@exception@std@@UEBAPEBDXZ
CONST	ENDS
;	COMDAT ??_7bad_alloc@std@@6B@
CONST	SEGMENT
??_7bad_alloc@std@@6B@ DQ FLAT:??_R4bad_alloc@std@@6B@	; std::bad_alloc::`vftable'
	DQ	FLAT:??_Ebad_alloc@std@@UEAAPEAXI@Z
	DQ	FLAT:?what@exception@std@@UEBAPEBDXZ
CONST	ENDS
;	COMDAT ??_C@_0BC@EOODALEL@Unknown?5exception@
CONST	SEGMENT
??_C@_0BC@EOODALEL@Unknown?5exception@ DB 'Unknown exception', 00H ; `string'
CONST	ENDS
;	COMDAT ??_7exception@std@@6B@
CONST	SEGMENT
??_7exception@std@@6B@ DQ FLAT:??_R4exception@std@@6B@	; std::exception::`vftable'
	DQ	FLAT:??_Eexception@std@@UEAAPEAXI@Z
	DQ	FLAT:?what@exception@std@@UEBAPEBDXZ
CONST	ENDS
;	COMDAT xdata
xdata	SEGMENT
$unwind$??$_Traits_equal@U?$char_traits@D@std@@@std@@YA_NQEBD_K01@Z DD 010401H
	DD	04204H
xdata	ENDS
;	COMDAT xdata
xdata	SEGMENT
$unwind$??$_Allocate_manually_vector_aligned@U_Default_allocate_traits@std@@@std@@YAPEAX_K@Z DD 010401H
	DD	04204H
xdata	ENDS
;	COMDAT xdata
xdata	SEGMENT
$unwind$??$_Maklocstr@D@std@@YAPEADPEBDPEADAEBU_Cvtvec@@@Z DD 060f01H
	DD	07640fH
	DD	06340fH
	DD	0700b320fH
xdata	ENDS
;	COMDAT xdata
xdata	SEGMENT
$unwind$??$_Allocate@$0BA@U_Default_allocate_traits@std@@$0A@@std@@YAPEAX_K@Z DD 010401H
	DD	04204H
xdata	ENDS
;	COMDAT xdata
xdata	SEGMENT
$unwind$??$_Deallocate@$0BA@$0A@@std@@YAXPEAX_K@Z DD 010401H
	DD	04204H
xdata	ENDS
;	COMDAT xdata
xdata	SEGMENT
$chain$5$??$_Reallocate_for@V<lambda_66f57f934f28d61049862f64df852ff0>@@PEBD@?$basic_string@DU?$char_traits@D@std@@V?$allocator@D@2@@std@@AEAAAEAV01@_KV<lambda_66f57f934f28d61049862f64df852ff0>@@PEBD@Z DD 040021H
	DD	09e400H
	DD	087400H
	DD	imagerel $LN68
	DD	imagerel $LN68+41
	DD	imagerel $unwind$??$_Reallocate_for@V<lambda_66f57f934f28d61049862f64df852ff0>@@PEBD@?$basic_string@DU?$char_traits@D@std@@V?$allocator@D@2@@std@@AEAAAEAV01@_KV<lambda_66f57f934f28d61049862f64df852ff0>@@PEBD@Z
xdata	ENDS
;	COMDAT xdata
xdata	SEGMENT
$chain$4$??$_Reallocate_for@V<lambda_66f57f934f28d61049862f64df852ff0>@@PEBD@?$basic_string@DU?$char_traits@D@std@@V?$allocator@D@2@@std@@AEAAAEAV01@_KV<lambda_66f57f934f28d61049862f64df852ff0>@@PEBD@Z DD 021H
	DD	imagerel $LN68
	DD	imagerel $LN68+41
	DD	imagerel $unwind$??$_Reallocate_for@V<lambda_66f57f934f28d61049862f64df852ff0>@@PEBD@?$basic_string@DU?$char_traits@D@std@@V?$allocator@D@2@@std@@AEAAAEAV01@_KV<lambda_66f57f934f28d61049862f64df852ff0>@@PEBD@Z
xdata	ENDS
;	COMDAT xdata
xdata	SEGMENT
$chain$3$??$_Reallocate_for@V<lambda_66f57f934f28d61049862f64df852ff0>@@PEBD@?$basic_string@DU?$char_traits@D@std@@V?$allocator@D@2@@std@@AEAAAEAV01@_KV<lambda_66f57f934f28d61049862f64df852ff0>@@PEBD@Z DD 040021H
	DD	09e400H
	DD	087400H
	DD	imagerel $LN68
	DD	imagerel $LN68+41
	DD	imagerel $unwind$??$_Reallocate_for@V<lambda_66f57f934f28d61049862f64df852ff0>@@PEBD@?$basic_string@DU?$char_traits@D@std@@V?$allocator@D@2@@std@@AEAAAEAV01@_KV<lambda_66f57f934f28d61049862f64df852ff0>@@PEBD@Z
xdata	ENDS
;	COMDAT xdata
xdata	SEGMENT
$chain$1$??$_Reallocate_for@V<lambda_66f57f934f28d61049862f64df852ff0>@@PEBD@?$basic_string@DU?$char_traits@D@std@@V?$allocator@D@2@@std@@AEAAAEAV01@_KV<lambda_66f57f934f28d61049862f64df852ff0>@@PEBD@Z DD 040a21H
	DD	09e40aH
	DD	087405H
	DD	imagerel $LN68
	DD	imagerel $LN68+41
	DD	imagerel $unwind$??$_Reallocate_for@V<lambda_66f57f934f28d61049862f64df852ff0>@@PEBD@?$basic_string@DU?$char_traits@D@std@@V?$allocator@D@2@@std@@AEAAAEAV01@_KV<lambda_66f57f934f28d61049862f64df852ff0>@@PEBD@Z
xdata	ENDS
;	COMDAT xdata
xdata	SEGMENT
$unwind$??$_Reallocate_for@V<lambda_66f57f934f28d61049862f64df852ff0>@@PEBD@?$basic_string@DU?$char_traits@D@std@@V?$allocator@D@2@@std@@AEAAAEAV01@_KV<lambda_66f57f934f28d61049862f64df852ff0>@@PEBD@Z DD 060d01H
	DD	0a340dH
	DD	0f009320dH
	DD	050066007H
xdata	ENDS
;	COMDAT xdata
xdata	SEGMENT
$unwind$??R<lambda_66f57f934f28d61049862f64df852ff0>@@QEBA@QEAD_KQEBD@Z DD 040a01H
	DD	06340aH
	DD	07006320aH
xdata	ENDS
;	COMDAT xdata
xdata	SEGMENT
$ip2state$??1sentry@?$basic_ostream@DU?$char_traits@D@std@@@std@@QEAA@XZ DB 04H
	DB	'*'
	DB	00H
	DB	'<'
	DB	02H
xdata	ENDS
;	COMDAT xdata
xdata	SEGMENT
$stateUnwindMap$??1sentry@?$basic_ostream@DU?$char_traits@D@std@@@std@@QEAA@XZ DB 02H
	DB	0eH
	DD	imagerel __std_terminate
xdata	ENDS
;	COMDAT xdata
xdata	SEGMENT
$cppxdata$??1sentry@?$basic_ostream@DU?$char_traits@D@std@@@std@@QEAA@XZ DB 068H
	DD	imagerel $stateUnwindMap$??1sentry@?$basic_ostream@DU?$char_traits@D@std@@@std@@QEAA@XZ
	DD	imagerel $ip2state$??1sentry@?$basic_ostream@DU?$char_traits@D@std@@@std@@QEAA@XZ
xdata	ENDS
;	COMDAT xdata
xdata	SEGMENT
$unwind$??1sentry@?$basic_ostream@DU?$char_traits@D@std@@@std@@QEAA@XZ DD 020619H
	DD	030023206H
	DD	imagerel __CxxFrameHandler4
	DD	imagerel $cppxdata$??1sentry@?$basic_ostream@DU?$char_traits@D@std@@@std@@QEAA@XZ
xdata	ENDS
;	COMDAT xdata
xdata	SEGMENT
$ip2state$??0sentry@?$basic_ostream@DU?$char_traits@D@std@@@std@@QEAA@AEAV12@@Z DB 04H
	DB	'X'
	DB	00H
	DB	'H'
	DB	02H
xdata	ENDS
;	COMDAT xdata
xdata	SEGMENT
$stateUnwindMap$??0sentry@?$basic_ostream@DU?$char_traits@D@std@@@std@@QEAA@AEAV12@@Z DB 02H
	DB	0cH
	DD	imagerel ??1_Sentry_base@?$basic_ostream@DU?$char_traits@D@std@@@std@@QEAA@XZ
	DB	060H
xdata	ENDS
;	COMDAT xdata
xdata	SEGMENT
$cppxdata$??0sentry@?$basic_ostream@DU?$char_traits@D@std@@@std@@QEAA@AEAV12@@Z DB 028H
	DD	imagerel $stateUnwindMap$??0sentry@?$basic_ostream@DU?$char_traits@D@std@@@std@@QEAA@AEAV12@@Z
	DD	imagerel $ip2state$??0sentry@?$basic_ostream@DU?$char_traits@D@std@@@std@@QEAA@AEAV12@@Z
xdata	ENDS
;	COMDAT xdata
xdata	SEGMENT
$unwind$??0sentry@?$basic_ostream@DU?$char_traits@D@std@@@std@@QEAA@AEAV12@@Z DD 040f11H
	DD	07340fH
	DD	0700b320fH
	DD	imagerel __CxxFrameHandler4
	DD	imagerel $cppxdata$??0sentry@?$basic_ostream@DU?$char_traits@D@std@@@std@@QEAA@AEAV12@@Z
xdata	ENDS
;	COMDAT xdata
xdata	SEGMENT
$ip2state$??1_Sentry_base@?$basic_ostream@DU?$char_traits@D@std@@@std@@QEAA@XZ DB 02H
	DB	'6'
	DB	00H
xdata	ENDS
;	COMDAT xdata
xdata	SEGMENT
$cppxdata$??1_Sentry_base@?$basic_ostream@DU?$char_traits@D@std@@@std@@QEAA@XZ DB 060H
	DD	imagerel $ip2state$??1_Sentry_base@?$basic_ostream@DU?$char_traits@D@std@@@std@@QEAA@XZ
xdata	ENDS
;	COMDAT xdata
xdata	SEGMENT
$unwind$??1_Sentry_base@?$basic_ostream@DU?$char_traits@D@std@@@std@@QEAA@XZ DD 010419H
	DD	04204H
	DD	imagerel __CxxFrameHandler4
	DD	imagerel $cppxdata$??1_Sentry_base@?$basic_ostream@DU?$char_traits@D@std@@@std@@QEAA@XZ
xdata	ENDS
;	COMDAT xdata
xdata	SEGMENT
$unwind$??0_Sentry_base@?$basic_ostream@DU?$char_traits@D@std@@@std@@QEAA@AEAV12@@Z DD 020601H
	DD	030023206H
xdata	ENDS
;	COMDAT xdata
xdata	SEGMENT
$unwind$??$?8DU?$char_traits@D@std@@V?$allocator@D@1@@std@@YA_NAEBV?$basic_string@DU?$char_traits@D@std@@V?$allocator@D@2@@0@QEBD@Z DD 010401H
	DD	04204H
xdata	ENDS
;	COMDAT voltbl
voltbl	SEGMENT
_volmd	DB	00H
voltbl	ENDS
;	COMDAT voltbl
voltbl	SEGMENT
_volmd	DB	00H
voltbl	ENDS
;	COMDAT xdata
xdata	SEGMENT
$unwind$main$catch$23 DD 020a01H
	DD	05006320aH
xdata	ENDS
;	COMDAT xdata
xdata	SEGMENT
$unwind$main$catch$22 DD 020a01H
	DD	05006320aH
xdata	ENDS
;	COMDAT xdata
xdata	SEGMENT
$ip2state$main DB 014H
	DB	'a', 02H
	DB	02H
	DB	01dH, 04H
	DB	06H
	DB	0feH
	DB	08H
	DB	'e', 02H
	DB	0aH
	DB	']', 04H
	DB	08H
	DB	'5', 07H
	DB	02H
	DB	01dH, 02H
	DB	00H
	DB	'.'
	DB	06H
	DB	018H
	DB	0aH
	DB	'd'
	DB	00H
xdata	ENDS
;	COMDAT xdata
xdata	SEGMENT
$handlerMap$main DB 04H
	DB	016H
	DD	imagerel ??_R0PEAD@8
	DB	01H, 03H
	DD	imagerel main$catch$22
	DB	0ddH, 018H
	DB	011H
	DB	080H
	DD	imagerel main$catch$23
	DB	089H, 018H
xdata	ENDS
;	COMDAT xdata
xdata	SEGMENT
$tryMap$main DB	02H
	DB	00H
	DB	08H
	DB	0aH
	DD	imagerel $handlerMap$main
xdata	ENDS
;	COMDAT xdata
xdata	SEGMENT
$stateUnwindMap$main DB 0cH
	DB	08H
	DB	0aH
	DD	imagerel ??1?$basic_string@DU?$char_traits@D@std@@V?$allocator@D@2@@std@@QEAA@XZ
	DB	041H
	DB	02H
	DB	03aH
	DD	imagerel ??1?$basic_string@DU?$char_traits@D@std@@V?$allocator@D@2@@std@@QEAA@XZ
	DB	0e0H
	DB	032H
	DD	imagerel ??1?$basic_string@DU?$char_traits@D@std@@V?$allocator@D@2@@std@@QEAA@XZ
	DB	0a0H
	DB	032H
	DD	imagerel ??1?$basic_string@DU?$char_traits@D@std@@V?$allocator@D@2@@std@@QEAA@XZ
	DB	060H
	DB	0d8H
xdata	ENDS
;	COMDAT xdata
xdata	SEGMENT
$cppxdata$main DB 038H
	DD	imagerel $stateUnwindMap$main
	DD	imagerel $tryMap$main
	DD	imagerel $ip2state$main
xdata	ENDS
;	COMDAT xdata
xdata	SEGMENT
$unwind$main DD	091b19H
	DD	01a011bH
	DD	0e012f014H
	DD	0c00ed010H
	DD	0600b700cH
	DD	0300aH
	DD	imagerel __CxxFrameHandler4
	DD	imagerel $cppxdata$main
xdata	ENDS
;	COMDAT xdata
xdata	SEGMENT
$unwind$??$endl@DU?$char_traits@D@std@@@std@@YAAEAV?$basic_ostream@DU?$char_traits@D@std@@@0@AEAV10@@Z DD 020601H
	DD	030023206H
xdata	ENDS
;	COMDAT voltbl
voltbl	SEGMENT
_volmd	DB	00H
voltbl	ENDS
;	COMDAT xdata
xdata	SEGMENT
$unwind$?catch$4@?0???$?6U?$char_traits@D@std@@@std@@YAAEAV?$basic_ostream@DU?$char_traits@D@std@@@0@AEAV10@PEBD@Z@4HA DD 020a01H
	DD	05006320aH
xdata	ENDS
;	COMDAT xdata
xdata	SEGMENT
$ip2state$??$?6U?$char_traits@D@std@@@std@@YAAEAV?$basic_ostream@DU?$char_traits@D@std@@@0@AEAV10@PEBD@Z DB 0eH
	DB	0e2H
	DB	00H
	DB	'T'
	DB	02H
	DB	0b6H
	DB	06H
	DB	0d8H
	DB	04H
	DB	'L'
	DB	0aH
	DB	'&'
	DB	0cH
	DB	'2'
	DB	00H
xdata	ENDS
;	COMDAT xdata
xdata	SEGMENT
$handlerMap$??$?6U?$char_traits@D@std@@@std@@YAAEAV?$basic_ostream@DU?$char_traits@D@std@@@0@AEAV10@PEBD@Z DB 02H
	DB	011H
	DB	080H
	DD	imagerel ?catch$4@?0???$?6U?$char_traits@D@std@@@std@@YAAEAV?$basic_ostream@DU?$char_traits@D@std@@@0@AEAV10@PEBD@Z@4HA
	DB	091H, 05H
xdata	ENDS
;	COMDAT xdata
xdata	SEGMENT
$tryMap$??$?6U?$char_traits@D@std@@@std@@YAAEAV?$basic_ostream@DU?$char_traits@D@std@@@0@AEAV10@PEBD@Z DB 02H
	DB	04H
	DB	04H
	DB	06H
	DD	imagerel $handlerMap$??$?6U?$char_traits@D@std@@@std@@YAAEAV?$basic_ostream@DU?$char_traits@D@std@@@0@AEAV10@PEBD@Z
xdata	ENDS
;	COMDAT xdata
xdata	SEGMENT
$stateUnwindMap$??$?6U?$char_traits@D@std@@@std@@YAAEAV?$basic_ostream@DU?$char_traits@D@std@@@0@AEAV10@PEBD@Z DB 0cH
	DB	0aH
	DD	imagerel ??1_Sentry_base@?$basic_ostream@DU?$char_traits@D@std@@@std@@QEAA@XZ
	DB	040H
	DB	03aH
	DD	imagerel ??1sentry@?$basic_ostream@DU?$char_traits@D@std@@@std@@QEAA@XZ
	DB	040H
	DB	030H
	DB	038H
	DB	07eH
	DD	imagerel __std_terminate
	DB	02eH
	DD	imagerel __std_terminate
xdata	ENDS
;	COMDAT xdata
xdata	SEGMENT
$cppxdata$??$?6U?$char_traits@D@std@@@std@@YAAEAV?$basic_ostream@DU?$char_traits@D@std@@@0@AEAV10@PEBD@Z DB 038H
	DD	imagerel $stateUnwindMap$??$?6U?$char_traits@D@std@@@std@@YAAEAV?$basic_ostream@DU?$char_traits@D@std@@@0@AEAV10@PEBD@Z
	DD	imagerel $tryMap$??$?6U?$char_traits@D@std@@@std@@YAAEAV?$basic_ostream@DU?$char_traits@D@std@@@0@AEAV10@PEBD@Z
	DD	imagerel $ip2state$??$?6U?$char_traits@D@std@@@std@@YAAEAV?$basic_ostream@DU?$char_traits@D@std@@@0@AEAV10@PEBD@Z
xdata	ENDS
;	COMDAT xdata
xdata	SEGMENT
$unwind$??$?6U?$char_traits@D@std@@@std@@YAAEAV?$basic_ostream@DU?$char_traits@D@std@@@0@AEAV10@PEBD@Z DD 081619H
	DD	0d3416H
	DD	0f0125216H
	DD	0c00ee010H
	DD	0600b700cH
	DD	imagerel __CxxFrameHandler4
	DD	imagerel $cppxdata$??$?6U?$char_traits@D@std@@@std@@YAAEAV?$basic_ostream@DU?$char_traits@D@std@@@0@AEAV10@PEBD@Z
xdata	ENDS
;	COMDAT xdata
xdata	SEGMENT
$ip2state$?time_sieve@@YAXII_N@Z DB 08H
	DB	'V'
	DB	00H
	DB	094H
	DB	02H
	DB	'=', 08H
	DB	04H
	DB	016H
	DB	00H
xdata	ENDS
;	COMDAT xdata
xdata	SEGMENT
$stateUnwindMap$?time_sieve@@YAXII_N@Z DB 04H
	DB	0aH
	DD	imagerel ??1Sieve@@QEAA@XZ
	DB	040H
	DB	03eH
	DD	imagerel __std_terminate
xdata	ENDS
;	COMDAT xdata
xdata	SEGMENT
$cppxdata$?time_sieve@@YAXII_N@Z DB 028H
	DD	imagerel $stateUnwindMap$?time_sieve@@YAXII_N@Z
	DD	imagerel $ip2state$?time_sieve@@YAXII_N@Z
xdata	ENDS
;	COMDAT xdata
xdata	SEGMENT
$unwind$?time_sieve@@YAXII_N@Z DD 0c2111H
	DD	0116421H
	DD	0f5421H
	DD	0e3421H
	DD	0f01d7221H
	DD	0d019e01bH
	DD	07015c017H
	DD	imagerel __CxxFrameHandler4
	DD	imagerel $cppxdata$?time_sieve@@YAXII_N@Z
xdata	ENDS
;	COMDAT xdata
xdata	SEGMENT
$unwind$??$_Getvals@_W@?$time_get@_WV?$istreambuf_iterator@_WU?$char_traits@_W@std@@@std@@@std@@IEAAX_WAEBV_Locinfo@1@@Z DD 040a01H
	DD	0c340aH
	DD	07006920aH
xdata	ENDS
;	COMDAT xdata
xdata	SEGMENT
$unwind$??$_Getvals@_W@?$time_get@DV?$istreambuf_iterator@DU?$char_traits@D@std@@@std@@@std@@IEAAX_WAEBV_Locinfo@1@@Z DD 040a01H
	DD	0c340aH
	DD	07006920aH
xdata	ENDS
;	COMDAT xdata
xdata	SEGMENT
$ip2state$??1Sieve@@QEAA@XZ DB 02H
	DB	010H
	DB	02H
xdata	ENDS
;	COMDAT xdata
xdata	SEGMENT
$stateUnwindMap$??1Sieve@@QEAA@XZ DB 02H
	DB	0eH
	DD	imagerel __std_terminate
xdata	ENDS
;	COMDAT xdata
xdata	SEGMENT
$cppxdata$??1Sieve@@QEAA@XZ DB 068H
	DD	imagerel $stateUnwindMap$??1Sieve@@QEAA@XZ
	DD	imagerel $ip2state$??1Sieve@@QEAA@XZ
xdata	ENDS
;	COMDAT xdata
xdata	SEGMENT
$unwind$??1Sieve@@QEAA@XZ DD 010419H
	DD	04204H
	DD	imagerel __CxxFrameHandler4
	DD	imagerel $cppxdata$??1Sieve@@QEAA@XZ
xdata	ENDS
;	COMDAT xdata
xdata	SEGMENT
$ip2state$??1tBitArray@@QEAA@XZ DB 02H
	DB	08H
	DB	00H
xdata	ENDS
;	COMDAT xdata
xdata	SEGMENT
$cppxdata$??1tBitArray@@QEAA@XZ DB 060H
	DD	imagerel $ip2state$??1tBitArray@@QEAA@XZ
xdata	ENDS
;	COMDAT xdata
xdata	SEGMENT
$unwind$??1tBitArray@@QEAA@XZ DD 010419H
	DD	04204H
	DD	imagerel __CxxFrameHandler4
	DD	imagerel $cppxdata$??1tBitArray@@QEAA@XZ
xdata	ENDS
;	COMDAT xdata
xdata	SEGMENT
$unwind$?stoul@std@@YAKAEBV?$basic_string@DU?$char_traits@D@std@@V?$allocator@D@2@@1@PEA_KH@Z DD 081401H
	DD	096414H
	DD	085414H
	DD	073414H
	DD	070103214H
xdata	ENDS
;	COMDAT xdata
xdata	SEGMENT
$unwind$?now@steady_clock@chrono@std@@SA?AV?$time_point@Usteady_clock@chrono@std@@V?$duration@_JU?$ratio@$00$0DLJKMKAA@@std@@@23@@23@XZ DD 040a01H
	DD	06340aH
	DD	07006320aH
xdata	ENDS
;	COMDAT xdata
xdata	SEGMENT
$unwind$?_Maklocwcs@std@@YAPEA_WPEB_W@Z DD 060f01H
	DD	07640fH
	DD	06340fH
	DD	0700b320fH
xdata	ENDS
;	COMDAT xdata
xdata	SEGMENT
$unwind$??$_Maklocstr@_W@std@@YAPEA_WPEBDPEA_WAEBU_Cvtvec@@@Z DD 0a1601H
	DD	0105416H
	DD	0f3416H
	DD	0f0127216H
	DD	0c00ee010H
	DD	0600b700cH
xdata	ENDS
;	COMDAT xdata
xdata	SEGMENT
$unwind$?_Tidy_deallocate@?$basic_string@DU?$char_traits@D@std@@V?$allocator@D@2@@std@@AEAAXXZ DD 020601H
	DD	030023206H
xdata	ENDS
;	COMDAT xdata
xdata	SEGMENT
$unwind$?_Equal@?$basic_string@DU?$char_traits@D@std@@V?$allocator@D@2@@std@@QEBA_NQEBD@Z DD 010401H
	DD	04204H
xdata	ENDS
;	COMDAT xdata
xdata	SEGMENT
$unwind$?substr@?$basic_string@DU?$char_traits@D@std@@V?$allocator@D@2@@std@@QEBA?AV12@_K0@Z DD 020601H
	DD	030023206H
xdata	ENDS
;	COMDAT xdata
xdata	SEGMENT
$chain$4$?assign@?$basic_string@DU?$char_traits@D@std@@V?$allocator@D@2@@std@@QEAAAEAV12@QEBD_K@Z DD 020021H
	DD	08e400H
	DD	imagerel $LN79
	DD	imagerel $LN79+91
	DD	imagerel $unwind$?assign@?$basic_string@DU?$char_traits@D@std@@V?$allocator@D@2@@std@@QEAAAEAV12@QEBD_K@Z
xdata	ENDS
;	COMDAT xdata
xdata	SEGMENT
$chain$3$?assign@?$basic_string@DU?$char_traits@D@std@@V?$allocator@D@2@@std@@QEAAAEAV12@QEBD_K@Z DD 021H
	DD	imagerel $LN79
	DD	imagerel $LN79+91
	DD	imagerel $unwind$?assign@?$basic_string@DU?$char_traits@D@std@@V?$allocator@D@2@@std@@QEAAAEAV12@QEBD_K@Z
xdata	ENDS
;	COMDAT xdata
xdata	SEGMENT
$chain$2$?assign@?$basic_string@DU?$char_traits@D@std@@V?$allocator@D@2@@std@@QEAAAEAV12@QEBD_K@Z DD 020021H
	DD	08e400H
	DD	imagerel $LN79
	DD	imagerel $LN79+91
	DD	imagerel $unwind$?assign@?$basic_string@DU?$char_traits@D@std@@V?$allocator@D@2@@std@@QEAAAEAV12@QEBD_K@Z
xdata	ENDS
;	COMDAT xdata
xdata	SEGMENT
$chain$1$?assign@?$basic_string@DU?$char_traits@D@std@@V?$allocator@D@2@@std@@QEAAAEAV12@QEBD_K@Z DD 021H
	DD	imagerel $LN79
	DD	imagerel $LN79+91
	DD	imagerel $unwind$?assign@?$basic_string@DU?$char_traits@D@std@@V?$allocator@D@2@@std@@QEAAAEAV12@QEBD_K@Z
xdata	ENDS
;	COMDAT xdata
xdata	SEGMENT
$chain$0$?assign@?$basic_string@DU?$char_traits@D@std@@V?$allocator@D@2@@std@@QEAAAEAV12@QEBD_K@Z DD 020521H
	DD	08e405H
	DD	imagerel $LN79
	DD	imagerel $LN79+91
	DD	imagerel $unwind$?assign@?$basic_string@DU?$char_traits@D@std@@V?$allocator@D@2@@std@@QEAAAEAV12@QEBD_K@Z
xdata	ENDS
;	COMDAT xdata
xdata	SEGMENT
$unwind$?assign@?$basic_string@DU?$char_traits@D@std@@V?$allocator@D@2@@std@@QEAAAEAV12@QEBD_K@Z DD 081201H
	DD	0a5412H
	DD	093412H
	DD	0f00e3212H
	DD	0600b700cH
xdata	ENDS
;	COMDAT xdata
xdata	SEGMENT
$unwind$?assign@?$basic_string@DU?$char_traits@D@std@@V?$allocator@D@2@@std@@QEAAAEAV12@AEBV12@_K_K@Z DD 010401H
	DD	04204H
xdata	ENDS
;	COMDAT xdata
xdata	SEGMENT
$unwind$??1?$basic_string@DU?$char_traits@D@std@@V?$allocator@D@2@@std@@QEAA@XZ DD 020601H
	DD	030023206H
xdata	ENDS
;	COMDAT xdata
xdata	SEGMENT
$unwind$??0?$basic_string@DU?$char_traits@D@std@@V?$allocator@D@2@@std@@QEAA@QEBD@Z DD 020601H
	DD	030023206H
xdata	ENDS
;	COMDAT xdata
xdata	SEGMENT
$unwind$??0?$basic_string@DU?$char_traits@D@std@@V?$allocator@D@2@@std@@QEAA@AEBV01@_K1AEBV?$allocator@D@1@@Z DD 020601H
	DD	030023206H
xdata	ENDS
;	COMDAT xdata
xdata	SEGMENT
$unwind$?_Xran@?$_String_val@U?$_Simple_types@D@std@@@std@@SAXXZ DD 010401H
	DD	04204H
xdata	ENDS
;	COMDAT xdata
xdata	SEGMENT
$unwind$?_Check_offset@?$_String_val@U?$_Simple_types@D@std@@@std@@QEBAX_K@Z DD 010401H
	DD	04204H
xdata	ENDS
;	COMDAT xdata
xdata	SEGMENT
$unwind$?allocate@?$allocator@D@std@@QEAAPEAD_K@Z DD 010401H
	DD	04204H
xdata	ENDS
;	COMDAT xdata
xdata	SEGMENT
$unwind$?deallocate@?$allocator@D@std@@QEAAXQEAD_K@Z DD 010401H
	DD	04204H
xdata	ENDS
;	COMDAT xdata
xdata	SEGMENT
$unwind$?_Xlen_string@std@@YAXXZ DD 010401H
	DD	04204H
xdata	ENDS
;	COMDAT xdata
xdata	SEGMENT
$unwind$?move@?$_Char_traits@DH@std@@SAPEADQEADQEBD_K@Z DD 020601H
	DD	030023206H
xdata	ENDS
;	COMDAT xdata
xdata	SEGMENT
$unwind$?copy@?$_Char_traits@DH@std@@SAPEADQEADQEBD_K@Z DD 020601H
	DD	030023206H
xdata	ENDS
;	COMDAT xdata
xdata	SEGMENT
$unwind$?_Adjust_manually_vector_aligned@std@@YAXAEAPEAXAEA_K@Z DD 010401H
	DD	04204H
xdata	ENDS
;	COMDAT xdata
xdata	SEGMENT
$unwind$?_Throw_bad_array_new_length@std@@YAXXZ DD 010401H
	DD	08204H
xdata	ENDS
;	COMDAT xdata
xdata	SEGMENT
$unwind$??_Gbad_array_new_length@std@@UEAAPEAXI@Z DD 040a01H
	DD	06340aH
	DD	07006320aH
xdata	ENDS
;	COMDAT xdata
xdata	SEGMENT
$unwind$??0bad_array_new_length@std@@QEAA@AEBV01@@Z DD 020601H
	DD	030023206H
xdata	ENDS
;	COMDAT xdata
xdata	SEGMENT
$unwind$??_Gbad_alloc@std@@UEAAPEAXI@Z DD 040a01H
	DD	06340aH
	DD	07006320aH
xdata	ENDS
;	COMDAT xdata
xdata	SEGMENT
$unwind$??0bad_alloc@std@@QEAA@AEBV01@@Z DD 020601H
	DD	030023206H
xdata	ENDS
;	COMDAT xdata
xdata	SEGMENT
$unwind$??_Gexception@std@@UEAAPEAXI@Z DD 040a01H
	DD	06340aH
	DD	07006320aH
xdata	ENDS
;	COMDAT xdata
xdata	SEGMENT
$unwind$??0exception@std@@QEAA@AEBV01@@Z DD 020601H
	DD	030023206H
xdata	ENDS
;	COMDAT xdata
xdata	SEGMENT
$unwind$wmemcpy DD 020601H
	DD	030023206H
xdata	ENDS
; Function compile flags: /Ogtpy
;	COMDAT ??$_Allocate_manually_vector_aligned@U_Default_allocate_traits@std@@@std@@YAPEAX_K@Z
_TEXT	SEGMENT
_Bytes$ = 48
??$_Allocate_manually_vector_aligned@U_Default_allocate_traits@std@@@std@@YAPEAX_K@Z PROC ; std::_Allocate_manually_vector_aligned<std::_Default_allocate_traits>, COMDAT
; File C:\myPrograms\vs2019\VC\Tools\MSVC\14.29.30133\include\xmemory
; Line 134
$LN17:
	sub	rsp, 40					; 00000028H
; Line 136
	lea	rax, QWORD PTR [rcx+39]
; Line 137
	cmp	rax, rcx
	jbe	SHORT $LN16@Allocate_m
; Line 85
	mov	rcx, rax
	call	??2@YAPEAX_K@Z				; operator new
	mov	rcx, rax
; Line 142
	test	rax, rax
	je	SHORT $LN7@Allocate_m
; Line 143
	add	rax, 39					; 00000027H
	and	rax, -32				; ffffffffffffffe0H
; Line 144
	mov	QWORD PTR [rax-8], rcx
; Line 150
	add	rsp, 40					; 00000028H
	ret	0
$LN7@Allocate_m:
; Line 142
	call	QWORD PTR __imp__invalid_parameter_noinfo_noreturn
	int	3
$LN16@Allocate_m:
; Line 138
	call	?_Throw_bad_array_new_length@std@@YAXXZ	; std::_Throw_bad_array_new_length
	int	3
$LN14@Allocate_m:
??$_Allocate_manually_vector_aligned@U_Default_allocate_traits@std@@@std@@YAPEAX_K@Z ENDP ; std::_Allocate_manually_vector_aligned<std::_Default_allocate_traits>
_TEXT	ENDS
; Function compile flags: /Ogtpy
;	COMDAT ??$_Maklocstr@D@std@@YAPEADPEBDPEADAEBU_Cvtvec@@@Z
_TEXT	SEGMENT
_Ptr$ = 48
__formal$ = 56
__formal$ = 64
??$_Maklocstr@D@std@@YAPEADPEBDPEADAEBU_Cvtvec@@@Z PROC	; std::_Maklocstr<char>, COMDAT
; File C:\myPrograms\vs2019\VC\Tools\MSVC\14.29.30133\include\xlocale
; Line 522
$LN15:
	mov	QWORD PTR [rsp+8], rbx
	mov	QWORD PTR [rsp+16], rsi
	push	rdi
	sub	rsp, 32					; 00000020H
	mov	rbx, rcx
; Line 524
	mov	rax, -1
	npad	7
$LL11@Maklocstr:
	cmp	BYTE PTR [rcx+rax+1], 0
	lea	rax, QWORD PTR [rax+1]
	jne	SHORT $LL11@Maklocstr
	lea	rsi, QWORD PTR [rax+1]
; Line 526
	mov	edx, 1
	mov	rcx, rsi
	call	QWORD PTR __imp_calloc
	mov	rdi, rax
; Line 528
	test	rax, rax
	je	SHORT $LN14@Maklocstr
; Line 532
	test	rsi, rsi
	je	SHORT $LN4@Maklocstr
	mov	r8, rsi
	mov	rdx, rbx
	mov	rcx, rax
	call	memcpy
$LN4@Maklocstr:
; Line 537
	mov	rbx, QWORD PTR [rsp+48]
	mov	rax, rdi
	mov	rsi, QWORD PTR [rsp+56]
	add	rsp, 32					; 00000020H
	pop	rdi
	ret	0
$LN14@Maklocstr:
; Line 529
	call	?_Xbad_alloc@std@@YAXXZ			; std::_Xbad_alloc
	int	3
$LN12@Maklocstr:
??$_Maklocstr@D@std@@YAPEADPEBDPEADAEBU_Cvtvec@@@Z ENDP	; std::_Maklocstr<char>
_TEXT	ENDS
; Function compile flags: /Ogtpy
;	COMDAT ??1sentry@?$basic_ostream@DU?$char_traits@D@std@@@std@@QEAA@XZ
_TEXT	SEGMENT
this$ = 48
??1sentry@?$basic_ostream@DU?$char_traits@D@std@@@std@@QEAA@XZ PROC ; std::basic_ostream<char,std::char_traits<char> >::sentry::~sentry, COMDAT
; File C:\myPrograms\vs2019\VC\Tools\MSVC\14.29.30133\include\ostream
; Line 109
$LN13:
	push	rbx
	sub	rsp, 32					; 00000020H
	mov	rbx, rcx
; Line 113
	call	?uncaught_exception@std@@YA_NXZ		; std::uncaught_exception
; Line 118
	test	al, al
	jne	SHORT $LN2@sentry
; Line 119
	mov	rcx, QWORD PTR [rbx]
	call	QWORD PTR __imp_?_Osfx@?$basic_ostream@DU?$char_traits@D@std@@@std@@QEAAXXZ
	npad	1
$LN2@sentry:
; Line 79
	mov	rdx, QWORD PTR [rbx]
	mov	rax, QWORD PTR [rdx]
	movsxd	rcx, DWORD PTR [rax+4]
; File C:\myPrograms\vs2019\VC\Tools\MSVC\14.29.30133\include\ios
; Line 80
	mov	rcx, QWORD PTR [rcx+rdx+72]
; File C:\myPrograms\vs2019\VC\Tools\MSVC\14.29.30133\include\ostream
; Line 80
	test	rcx, rcx
	je	SHORT $LN10@sentry
; Line 81
	mov	rax, QWORD PTR [rcx]
	call	QWORD PTR [rax+16]
	npad	1
$LN10@sentry:
; Line 121
	add	rsp, 32					; 00000020H
	pop	rbx
	ret	0
??1sentry@?$basic_ostream@DU?$char_traits@D@std@@@std@@QEAA@XZ ENDP ; std::basic_ostream<char,std::char_traits<char> >::sentry::~sentry
_TEXT	ENDS
; Function compile flags: /Ogtpy
;	COMDAT ??1_Sentry_base@?$basic_ostream@DU?$char_traits@D@std@@@std@@QEAA@XZ
_TEXT	SEGMENT
this$ = 48
??1_Sentry_base@?$basic_ostream@DU?$char_traits@D@std@@@std@@QEAA@XZ PROC ; std::basic_ostream<char,std::char_traits<char> >::_Sentry_base::~_Sentry_base, COMDAT
; File C:\myPrograms\vs2019\VC\Tools\MSVC\14.29.30133\include\ostream
; Line 78
$LN8:
	sub	rsp, 40					; 00000028H
; Line 79
	mov	rdx, QWORD PTR [rcx]
	mov	rax, QWORD PTR [rdx]
	movsxd	rcx, DWORD PTR [rax+4]
; File C:\myPrograms\vs2019\VC\Tools\MSVC\14.29.30133\include\ios
; Line 80
	mov	rcx, QWORD PTR [rcx+rdx+72]
; File C:\myPrograms\vs2019\VC\Tools\MSVC\14.29.30133\include\ostream
; Line 80
	test	rcx, rcx
	je	SHORT $LN2@Sentry_bas
; Line 81
	mov	rax, QWORD PTR [rcx]
	call	QWORD PTR [rax+16]
	npad	1
$LN2@Sentry_bas:
; Line 83
	add	rsp, 40					; 00000028H
	ret	0
??1_Sentry_base@?$basic_ostream@DU?$char_traits@D@std@@@std@@QEAA@XZ ENDP ; std::basic_ostream<char,std::char_traits<char> >::_Sentry_base::~_Sentry_base
_TEXT	ENDS
; Function compile flags: /Ogtpy
;	COMDAT main
_TEXT	SEGMENT
$T1 = 32
prime_limit$1$ = 36
time_limit$1$ = 40
$T2 = 48
$T3 = 48
par$4 = 80
cmd$5 = 112
arg$6 = 144
_Eptr$7 = 176
_Eptr$8 = 184
szErr$9 = 192
argc$ = 272
argv$ = 280
tv2238 = 288
i$1$ = 296
main	PROC						; COMDAT
; File D:\myProjects\projects.cpp\sieve\src\primeSieve.cpp
; Line 49
$LN531:
	mov	QWORD PTR [rsp+16], rdx
	mov	DWORD PTR [rsp+8], ecx
	push	rbx
	push	rsi
	push	rdi
	push	r12
	push	r13
	push	r14
	push	r15
	sub	rsp, 208				; 000000d0H
	mov	eax, ecx
	xor	ecx, ecx
	mov	DWORD PTR $T1[rsp], ecx
; Line 51
	mov	ebx, 1000000				; 000f4240H
	mov	DWORD PTR prime_limit$1$[rsp], ebx
; Line 52
	mov	edi, 5000				; 00001388H
	mov	DWORD PTR time_limit$1$[rsp], edi
; Line 53
	xor	r15b, r15b
	mov	DWORD PTR tv2238[rsp], r15d
; Line 56
	mov	edi, 1
$LN521@main:
	mov	DWORD PTR i$1$[rsp], edi
	cmp	edi, eax
	jge	$LN3@main
; Line 57
	movsxd	rax, edi
	mov	rdx, QWORD PTR [rdx+rax*8]
; File C:\myPrograms\vs2019\VC\Tools\MSVC\14.29.30133\include\xstring
; Line 2346
	mov	QWORD PTR arg$6[rsp], rcx
; Line 4596
	mov	QWORD PTR arg$6[rsp+16], rcx
; Line 4610
	mov	QWORD PTR arg$6[rsp+24], 15
; Line 4612
	mov	BYTE PTR arg$6[rsp], 0
; Line 412
	mov	r8, -1
$LL514@main:
	inc	r8
	cmp	BYTE PTR [rdx+r8], 0
	jne	SHORT $LL514@main
; Line 3264
	lea	rcx, QWORD PTR arg$6[rsp]
	call	?assign@?$basic_string@DU?$char_traits@D@std@@V?$allocator@D@2@@std@@QEAAAEAV12@QEBD_K@Z ; std::basic_string<char,std::char_traits<char>,std::allocator<char> >::assign
	npad	1
; File D:\myProjects\projects.cpp\sieve\src\primeSieve.cpp
; Line 58
	mov	rbx, QWORD PTR arg$6[rsp+16]
	mov	r13, QWORD PTR arg$6[rsp]
	mov	r12, QWORD PTR arg$6[rsp+24]
	cmp	rbx, 3
	jb	$LN458@main
; File C:\myPrograms\vs2019\VC\Tools\MSVC\14.29.30133\include\xstring
; Line 2346
	xor	edi, edi
	mov	QWORD PTR cmd$5[rsp], rdi
; Line 4610
	mov	QWORD PTR cmd$5[rsp+24], 15
; Line 4612
	mov	BYTE PTR cmd$5[rsp], dil
; Line 2305
	lea	rdx, QWORD PTR arg$6[rsp]
; Line 2306
	cmp	r12, 16
	cmovae	rdx, r13
; Line 3248
	mov	QWORD PTR cmd$5[rsp+16], 3
; Line 122
	lea	r8d, QWORD PTR [rdi+3]
	lea	rcx, QWORD PTR cmd$5[rsp]
	call	memmove
; Line 3250
	mov	BYTE PTR cmd$5[rsp+3], dil
; Line 4367
	mov	r15d, DWORD PTR $T1[rsp]
	or	r15d, 1
; Line 2346
	mov	QWORD PTR par$4[rsp], rdi
; Line 4596
	mov	QWORD PTR par$4[rsp+16], rdi
; Line 4610
	mov	QWORD PTR par$4[rsp+24], 15
; Line 4612
	mov	BYTE PTR par$4[rsp], dil
; Line 2342
	lea	rax, QWORD PTR [rbx-3]
	mov	rsi, -1
	cmp	rax, rsi
	cmovb	rsi, rax
; Line 2305
	lea	r14, QWORD PTR arg$6[rsp]
; Line 2306
	cmp	r12, 16
	cmovae	r14, r13
; Line 3224
	cmp	rsi, 15
; Line 3246
	ja	SHORT $LN174@main
; Line 3248
	mov	QWORD PTR par$4[rsp+16], rsi
; Line 122
	mov	r8, rsi
	lea	rdx, QWORD PTR [r14+3]
	lea	rcx, QWORD PTR par$4[rsp]
	call	memmove
; Line 3250
	mov	BYTE PTR par$4[rsp+rsi], dil
; Line 3251
	jmp	$LN186@main
$LN174@main:
; Line 4508
	mov	rax, 9223372036854775807		; 7fffffffffffffffH
	cmp	rsi, rax
	ja	$LN525@main
; Line 4488
	mov	rbx, rsi
	or	rbx, 15
	cmp	rbx, rax
; Line 4489
	jbe	SHORT $LN191@main
; Line 4490
	mov	rbx, rax
	mov	rax, -9223372036854775769		; 8000000000000027H
$LN209@main:
; File C:\myPrograms\vs2019\VC\Tools\MSVC\14.29.30133\include\xmemory
; Line 85
	mov	rcx, rax
	call	??2@YAPEAX_K@Z				; operator new
; Line 142
	test	rax, rax
	je	$LN438@main
; Line 143
	lea	rdi, QWORD PTR [rax+39]
	and	rdi, -32				; ffffffffffffffe0H
; Line 144
	mov	QWORD PTR [rdi-8], rax
; Line 238
	jmp	SHORT $LN200@main
$LN191@main:
; File C:\myPrograms\vs2019\VC\Tools\MSVC\14.29.30133\include\xstring
; Line 4497
	cmp	rbx, 22
	mov	eax, 22
	cmovb	rbx, rax
; Line 4515
	lea	rcx, QWORD PTR [rbx+1]
; File C:\myPrograms\vs2019\VC\Tools\MSVC\14.29.30133\include\xmemory
; Line 237
	cmp	rcx, 4096				; 00001000H
	jb	SHORT $LN199@main
; Line 136
	lea	rax, QWORD PTR [rcx+39]
; Line 137
	cmp	rax, rcx
	jbe	$LN526@main
	jmp	SHORT $LN209@main
$LN199@main:
; Line 243
	test	rcx, rcx
	je	SHORT $LN200@main
; Line 85
	call	??2@YAPEAX_K@Z				; operator new
	mov	rdi, rax
$LN200@main:
; File C:\myPrograms\vs2019\VC\Tools\MSVC\14.29.30133\include\xstring
; Line 4523
	mov	QWORD PTR par$4[rsp+16], rsi
; Line 4524
	mov	QWORD PTR par$4[rsp+24], rbx
; Line 65
	mov	r8, rsi
	lea	rdx, QWORD PTR [r14+3]
	mov	rcx, rdi
	call	memcpy
; Line 3258
	mov	BYTE PTR [rdi+rsi], 0
; Line 4530
	mov	QWORD PTR par$4[rsp], rdi
	xor	edi, edi
$LN186@main:
; Line 4367
	or	r15d, 2
	mov	DWORD PTR $T1[rsp], r15d
; Line 2305
	lea	rax, QWORD PTR cmd$5[rsp]
; Line 2306
	mov	rsi, QWORD PTR cmd$5[rsp]
	mov	r14, QWORD PTR cmd$5[rsp+24]
	cmp	r14, 16
	cmovae	rax, rsi
; Line 583
	mov	r15, QWORD PTR cmd$5[rsp+16]
	cmp	r15, 3
	jne	SHORT $LN257@main
; Line 392
	cmp	BYTE PTR [rax], 45			; 0000002dH
	jne	SHORT $LN512@main
	cmp	BYTE PTR [rax+1], 45			; 0000002dH
	jne	SHORT $LN512@main
	cmp	BYTE PTR [rax+2], 116			; 00000074H
	jne	SHORT $LN512@main
	mov	eax, edi
	jmp	SHORT $LN513@main
$LN512@main:
	sbb	eax, eax
	or	eax, 1
$LN513@main:
; Line 583
	test	eax, eax
	jne	SHORT $LN257@main
	mov	al, 1
	jmp	SHORT $LN258@main
$LN257@main:
	xor	al, al
$LN258@main:
; File D:\myProjects\projects.cpp\sieve\src\primeSieve.cpp
; Line 61
	test	al, al
	je	$LN515@main
; File C:\myPrograms\vs2019\VC\Tools\MSVC\14.29.30133\include\xstring
; Line 2305
	lea	rdx, QWORD PTR par$4[rsp]
; Line 2306
	cmp	QWORD PTR par$4[rsp+24], 16
	cmovae	rdx, QWORD PTR par$4[rsp]
; Line 2346
	mov	QWORD PTR $T3[rsp], rdi
; Line 4596
	mov	QWORD PTR $T3[rsp+16], rdi
; Line 4610
	mov	QWORD PTR $T3[rsp+24], 15
; Line 4612
	mov	BYTE PTR $T3[rsp], 0
; Line 412
	mov	r8, -1
$LL511@main:
	inc	r8
	cmp	BYTE PTR [rdx+r8], 0
	jne	SHORT $LL511@main
; Line 3264
	lea	rcx, QWORD PTR $T3[rsp]
	call	?assign@?$basic_string@DU?$char_traits@D@std@@V?$allocator@D@2@@std@@QEAAAEAV12@QEBD_K@Z ; std::basic_string<char,std::char_traits<char>,std::allocator<char> >::assign
	npad	1
; File C:\myPrograms\vs2019\VC\Tools\MSVC\14.29.30133\include\string
; Line 136
	call	QWORD PTR __imp__errno
	mov	rdi, rax
; File C:\myPrograms\vs2019\VC\Tools\MSVC\14.29.30133\include\xstring
; Line 2305
	lea	rbx, QWORD PTR $T3[rsp]
; Line 2306
	cmp	QWORD PTR $T3[rsp+24], 16
	cmovae	rbx, QWORD PTR $T3[rsp]
; File C:\myPrograms\vs2019\VC\Tools\MSVC\14.29.30133\include\string
; Line 139
	mov	DWORD PTR [rax], 0
; Line 140
	mov	r8d, 10
	lea	rdx, QWORD PTR _Eptr$7[rsp]
	mov	rcx, rbx
	call	QWORD PTR __imp_strtoul
	mov	DWORD PTR time_limit$1$[rsp], eax
; Line 142
	cmp	rbx, QWORD PTR _Eptr$7[rsp]
	je	$LN527@main
; Line 146
	cmp	DWORD PTR [rdi], 34			; 00000022H
	je	$LN528@main
; File C:\myPrograms\vs2019\VC\Tools\MSVC\14.29.30133\include\xstring
; Line 4618
	mov	rdx, QWORD PTR $T3[rsp+24]
	cmp	rdx, 16
	jb	SHORT $LN515@main
; Line 4622
	inc	rdx
; File C:\myPrograms\vs2019\VC\Tools\MSVC\14.29.30133\include\xmemory
; Line 835
	mov	rcx, QWORD PTR $T3[rsp]
	mov	rax, rcx
; Line 260
	cmp	rdx, 4096				; 00001000H
	jb	SHORT $LN318@main
; Line 155
	add	rdx, 39					; 00000027H
; Line 158
	mov	rcx, QWORD PTR [rcx-8]
	sub	rax, rcx
; Line 172
	add	rax, -8
	cmp	rax, 31
	jbe	SHORT $LN318@main
	call	QWORD PTR __imp__invalid_parameter_noinfo_noreturn
	int	3
$LN318@main:
; Line 264
	call	??3@YAXPEAX_K@Z				; operator delete
$LN515@main:
; File C:\myPrograms\vs2019\VC\Tools\MSVC\14.29.30133\include\xstring
; Line 2305
	lea	rax, QWORD PTR cmd$5[rsp]
; Line 2306
	cmp	r14, 16
	cmovae	rax, rsi
; Line 583
	cmp	r15, 3
	jne	SHORT $LN336@main
; Line 392
	cmp	BYTE PTR [rax], 45			; 0000002dH
	jne	SHORT $LN509@main
	cmp	BYTE PTR [rax+1], 45			; 0000002dH
	jne	SHORT $LN509@main
	cmp	BYTE PTR [rax+2], 110			; 0000006eH
	jne	SHORT $LN509@main
	xor	eax, eax
	jmp	SHORT $LN510@main
$LN509@main:
	sbb	eax, eax
	or	eax, 1
$LN510@main:
; Line 583
	test	eax, eax
	jne	SHORT $LN336@main
	mov	al, 1
	jmp	SHORT $LN337@main
$LN336@main:
	xor	al, al
$LN337@main:
; File D:\myProjects\projects.cpp\sieve\src\primeSieve.cpp
; Line 64
	test	al, al
	je	$LN516@main
; File C:\myPrograms\vs2019\VC\Tools\MSVC\14.29.30133\include\xstring
; Line 2305
	lea	rdx, QWORD PTR par$4[rsp]
; Line 2306
	cmp	QWORD PTR par$4[rsp+24], 16
	cmovae	rdx, QWORD PTR par$4[rsp]
; Line 2346
	xor	eax, eax
	mov	QWORD PTR $T2[rsp], rax
; Line 4596
	mov	QWORD PTR $T2[rsp+16], rax
; Line 4610
	mov	QWORD PTR $T2[rsp+24], 15
; Line 4612
	mov	BYTE PTR $T2[rsp], al
; Line 412
	mov	r8, -1
	npad	7
$LL508@main:
	inc	r8
	cmp	BYTE PTR [rdx+r8], al
	jne	SHORT $LL508@main
; Line 3264
	lea	rcx, QWORD PTR $T2[rsp]
	call	?assign@?$basic_string@DU?$char_traits@D@std@@V?$allocator@D@2@@std@@QEAAAEAV12@QEBD_K@Z ; std::basic_string<char,std::char_traits<char>,std::allocator<char> >::assign
	npad	1
; File C:\myPrograms\vs2019\VC\Tools\MSVC\14.29.30133\include\string
; Line 136
	call	QWORD PTR __imp__errno
	mov	rdi, rax
; File C:\myPrograms\vs2019\VC\Tools\MSVC\14.29.30133\include\xstring
; Line 2305
	lea	rbx, QWORD PTR $T2[rsp]
; Line 2306
	cmp	QWORD PTR $T2[rsp+24], 16
	cmovae	rbx, QWORD PTR $T2[rsp]
; File C:\myPrograms\vs2019\VC\Tools\MSVC\14.29.30133\include\string
; Line 139
	mov	DWORD PTR [rax], 0
; Line 140
	mov	r8d, 10
	lea	rdx, QWORD PTR _Eptr$8[rsp]
	mov	rcx, rbx
	call	QWORD PTR __imp_strtoul
	mov	DWORD PTR prime_limit$1$[rsp], eax
; Line 142
	cmp	rbx, QWORD PTR _Eptr$8[rsp]
	je	$LN529@main
; Line 146
	cmp	DWORD PTR [rdi], 34			; 00000022H
	je	$LN530@main
; File C:\myPrograms\vs2019\VC\Tools\MSVC\14.29.30133\include\xstring
; Line 4618
	mov	rdx, QWORD PTR $T2[rsp+24]
	cmp	rdx, 16
	jb	SHORT $LN516@main
; Line 4622
	inc	rdx
; File C:\myPrograms\vs2019\VC\Tools\MSVC\14.29.30133\include\xmemory
; Line 835
	mov	rcx, QWORD PTR $T2[rsp]
	mov	rax, rcx
; Line 260
	cmp	rdx, 4096				; 00001000H
	jb	SHORT $LN397@main
; Line 155
	add	rdx, 39					; 00000027H
; Line 158
	mov	rcx, QWORD PTR [rcx-8]
	sub	rax, rcx
; Line 172
	add	rax, -8
	cmp	rax, 31
	jbe	SHORT $LN397@main
	call	QWORD PTR __imp__invalid_parameter_noinfo_noreturn
	int	3
$LN397@main:
; Line 264
	call	??3@YAXPEAX_K@Z				; operator delete
$LN516@main:
; File C:\myPrograms\vs2019\VC\Tools\MSVC\14.29.30133\include\xstring
; Line 2305
	lea	rax, QWORD PTR cmd$5[rsp]
; Line 2306
	cmp	r14, 16
	cmovae	rax, rsi
; Line 583
	cmp	r15, 3
	jne	SHORT $LN519@main
; Line 392
	cmp	BYTE PTR [rax], 45			; 0000002dH
	jne	SHORT $LN506@main
	cmp	BYTE PTR [rax+1], 45			; 0000002dH
	jne	SHORT $LN506@main
	cmp	BYTE PTR [rax+2], 115			; 00000073H
	jne	SHORT $LN506@main
	xor	eax, eax
	jmp	SHORT $LN507@main
$LN506@main:
	sbb	eax, eax
	or	eax, 1
$LN507@main:
; Line 583
	mov	r15d, DWORD PTR tv2238[rsp]
	movzx	r15d, r15b
	test	eax, eax
	mov	eax, 1
	cmove	r15d, eax
	mov	DWORD PTR tv2238[rsp], r15d
	jmp	SHORT $LN9@main
$LN519@main:
	mov	r15d, DWORD PTR tv2238[rsp]
$LN9@main:
; Line 4618
	mov	rdx, QWORD PTR par$4[rsp+24]
	cmp	rdx, 16
	jb	SHORT $LN431@main
; Line 4622
	inc	rdx
; File C:\myPrograms\vs2019\VC\Tools\MSVC\14.29.30133\include\xmemory
; Line 835
	mov	rcx, QWORD PTR par$4[rsp]
	mov	rax, rcx
; Line 260
	cmp	rdx, 4096				; 00001000H
	jb	SHORT $LN441@main
; Line 155
	add	rdx, 39					; 00000027H
; Line 158
	mov	rcx, QWORD PTR [rcx-8]
	sub	rax, rcx
; Line 172
	add	rax, -8
	cmp	rax, 31
	jbe	SHORT $LN441@main
$LN438@main:
	call	QWORD PTR __imp__invalid_parameter_noinfo_noreturn
	int	3
$LN441@main:
; Line 264
	call	??3@YAXPEAX_K@Z				; operator delete
	npad	1
$LN431@main:
; File C:\myPrograms\vs2019\VC\Tools\MSVC\14.29.30133\include\xstring
; Line 4618
	cmp	r14, 16
	jb	SHORT $LN518@main
; Line 4622
	lea	rdx, QWORD PTR [r14+1]
; File C:\myPrograms\vs2019\VC\Tools\MSVC\14.29.30133\include\xmemory
; Line 835
	mov	rax, rsi
; Line 260
	cmp	rdx, 4096				; 00001000H
	jb	SHORT $LN468@main
; Line 155
	add	rdx, 39					; 00000027H
; Line 158
	mov	rsi, QWORD PTR [rsi-8]
	sub	rax, rsi
; Line 172
	add	rax, -8
	cmp	rax, 31
	jbe	SHORT $LN468@main
	call	QWORD PTR __imp__invalid_parameter_noinfo_noreturn
	int	3
$LN468@main:
; Line 264
	mov	rcx, rsi
	call	??3@YAXPEAX_K@Z				; operator delete
$LN518@main:
; File D:\myProjects\projects.cpp\sieve\src\primeSieve.cpp
; Line 71
	mov	edi, DWORD PTR i$1$[rsp]
$LN458@main:
; File C:\myPrograms\vs2019\VC\Tools\MSVC\14.29.30133\include\xstring
; Line 2319
	cmp	r12, 16
; Line 4618
	jb	SHORT $LN485@main
; Line 4622
	lea	rdx, QWORD PTR [r12+1]
; File C:\myPrograms\vs2019\VC\Tools\MSVC\14.29.30133\include\xmemory
; Line 835
	mov	rax, r13
; Line 260
	cmp	rdx, 4096				; 00001000H
	jb	SHORT $LN495@main
; Line 155
	add	rdx, 39					; 00000027H
; Line 158
	mov	r13, QWORD PTR [r13-8]
	sub	rax, r13
; Line 172
	add	rax, -8
	cmp	rax, 31
	jbe	SHORT $LN495@main
	call	QWORD PTR __imp__invalid_parameter_noinfo_noreturn
	int	3
$LN495@main:
; Line 264
	mov	rcx, r13
	call	??3@YAXPEAX_K@Z				; operator delete
$LN485@main:
; File D:\myProjects\projects.cpp\sieve\src\primeSieve.cpp
; Line 56
	inc	edi
	mov	rdx, QWORD PTR argv$[rsp]
	mov	eax, DWORD PTR argc$[rsp]
	xor	ecx, ecx
	jmp	$LN521@main
$LN3@main:
; Line 72
	mov	rdx, QWORD PTR [rdx]
	mov	rcx, QWORD PTR __imp_?cout@std@@3V?$basic_ostream@DU?$char_traits@D@std@@@1@A
	call	??$?6U?$char_traits@D@std@@@std@@YAAEAV?$basic_ostream@DU?$char_traits@D@std@@@0@AEAV10@PEBD@Z ; std::operator<<<std::char_traits<char> >
	lea	rdx, OFFSET FLAT:??$endl@DU?$char_traits@D@std@@@std@@YAAEAV?$basic_ostream@DU?$char_traits@D@std@@@0@AEAV10@@Z ; std::endl<char,std::char_traits<char> >
	mov	rcx, rax
	call	QWORD PTR __imp_??6?$basic_ostream@DU?$char_traits@D@std@@@std@@QEAAAEAV01@P6AAEAV01@AEAV01@@Z@Z
; Line 73
	lea	rdx, OFFSET FLAT:??_C@_03EHAIMEJK@?9?9n@
	mov	rcx, QWORD PTR __imp_?cout@std@@3V?$basic_ostream@DU?$char_traits@D@std@@@1@A
	call	??$?6U?$char_traits@D@std@@@std@@YAAEAV?$basic_ostream@DU?$char_traits@D@std@@@0@AEAV10@PEBD@Z ; std::operator<<<std::char_traits<char> >
	mov	ebx, DWORD PTR prime_limit$1$[rsp]
	mov	edx, ebx
	mov	rcx, rax
	call	QWORD PTR __imp_??6?$basic_ostream@DU?$char_traits@D@std@@@std@@QEAAAEAV01@I@Z
	lea	rdx, OFFSET FLAT:??$endl@DU?$char_traits@D@std@@@std@@YAAEAV?$basic_ostream@DU?$char_traits@D@std@@@0@AEAV10@@Z ; std::endl<char,std::char_traits<char> >
	mov	rcx, rax
	call	QWORD PTR __imp_??6?$basic_ostream@DU?$char_traits@D@std@@@std@@QEAAAEAV01@P6AAEAV01@AEAV01@@Z@Z
; Line 74
	lea	rdx, OFFSET FLAT:??_C@_03PHCFDOEB@?9?9t@
	mov	rcx, QWORD PTR __imp_?cout@std@@3V?$basic_ostream@DU?$char_traits@D@std@@@1@A
	call	??$?6U?$char_traits@D@std@@@std@@YAAEAV?$basic_ostream@DU?$char_traits@D@std@@@0@AEAV10@PEBD@Z ; std::operator<<<std::char_traits<char> >
	mov	edi, DWORD PTR time_limit$1$[rsp]
	mov	edx, edi
	mov	rcx, rax
	call	QWORD PTR __imp_??6?$basic_ostream@DU?$char_traits@D@std@@@std@@QEAAAEAV01@I@Z
	lea	rdx, OFFSET FLAT:??$endl@DU?$char_traits@D@std@@@std@@YAAEAV?$basic_ostream@DU?$char_traits@D@std@@@0@AEAV10@@Z ; std::endl<char,std::char_traits<char> >
	mov	rcx, rax
	call	QWORD PTR __imp_??6?$basic_ostream@DU?$char_traits@D@std@@@std@@QEAAAEAV01@P6AAEAV01@AEAV01@@Z@Z
; Line 76
	movzx	r8d, r15b
	mov	edx, edi
	mov	ecx, ebx
	call	?time_sieve@@YAXII_N@Z			; time_sieve
	npad	1
$LN22@main:
; Line 86
	xor	eax, eax
; Line 87
	add	rsp, 208				; 000000d0H
	pop	r15
	pop	r14
	pop	r13
	pop	r12
	pop	rdi
	pop	rsi
	pop	rbx
	ret	0
$LN20@main:
; Line 81
	jmp	SHORT $LN22@main
$LN525@main:
; File C:\myPrograms\vs2019\VC\Tools\MSVC\14.29.30133\include\xstring
; Line 4509
	call	?_Xlen_string@std@@YAXXZ		; std::_Xlen_string
	npad	1
$LN526@main:
; File C:\myPrograms\vs2019\VC\Tools\MSVC\14.29.30133\include\xmemory
; Line 138
	call	?_Throw_bad_array_new_length@std@@YAXXZ	; std::_Throw_bad_array_new_length
	npad	1
$LN527@main:
; File C:\myPrograms\vs2019\VC\Tools\MSVC\14.29.30133\include\string
; Line 143
	lea	rcx, OFFSET FLAT:??_C@_0BH@DPNNDOEK@invalid?5stoul?5argument@
	call	?_Xinvalid_argument@std@@YAXPEBD@Z	; std::_Xinvalid_argument
$LN528@main:
; Line 147
	lea	rcx, OFFSET FLAT:??_C@_0BM@MOLGGFGJ@stoul?5argument?5out?5of?5range@
	call	?_Xout_of_range@std@@YAXPEBD@Z		; std::_Xout_of_range
	npad	1
$LN529@main:
; Line 143
	lea	rcx, OFFSET FLAT:??_C@_0BH@DPNNDOEK@invalid?5stoul?5argument@
	call	?_Xinvalid_argument@std@@YAXPEBD@Z	; std::_Xinvalid_argument
$LN530@main:
; Line 147
	lea	rcx, OFFSET FLAT:??_C@_0BM@MOLGGFGJ@stoul?5argument?5out?5of?5range@
	call	?_Xout_of_range@std@@YAXPEBD@Z		; std::_Xout_of_range
	int	3
$LN520@main:
	int	3
main	ENDP
_TEXT	ENDS
;	COMDAT text$x
text$x	SEGMENT
$T1 = 32
prime_limit$1$ = 36
time_limit$1$ = 40
$T2 = 48
$T3 = 48
par$4 = 80
cmd$5 = 112
arg$6 = 144
_Eptr$7 = 176
_Eptr$8 = 184
szErr$9 = 192
argc$ = 272
argv$ = 280
tv2238 = 288
i$1$ = 296
main$dtor$0 PROC
	lea	rcx, QWORD PTR arg$6[rdx]
	jmp	??1?$basic_string@DU?$char_traits@D@std@@V?$allocator@D@2@@std@@QEAA@XZ ; std::basic_string<char,std::char_traits<char>,std::allocator<char> >::~basic_string<char,std::char_traits<char>,std::allocator<char> >
main$dtor$0 ENDP
text$x	ENDS
;	COMDAT text$x
text$x	SEGMENT
$T1 = 32
prime_limit$1$ = 36
time_limit$1$ = 40
$T2 = 48
$T3 = 48
par$4 = 80
cmd$5 = 112
arg$6 = 144
_Eptr$7 = 176
_Eptr$8 = 184
szErr$9 = 192
argc$ = 272
argv$ = 280
tv2238 = 288
i$1$ = 296
main$dtor$1 PROC
	lea	rcx, QWORD PTR cmd$5[rdx]
	jmp	??1?$basic_string@DU?$char_traits@D@std@@V?$allocator@D@2@@std@@QEAA@XZ ; std::basic_string<char,std::char_traits<char>,std::allocator<char> >::~basic_string<char,std::char_traits<char>,std::allocator<char> >
main$dtor$1 ENDP
text$x	ENDS
;	COMDAT text$x
text$x	SEGMENT
$T1 = 32
prime_limit$1$ = 36
time_limit$1$ = 40
$T2 = 48
$T3 = 48
par$4 = 80
cmd$5 = 112
arg$6 = 144
_Eptr$7 = 176
_Eptr$8 = 184
szErr$9 = 192
argc$ = 272
argv$ = 280
tv2238 = 288
i$1$ = 296
main$dtor$2 PROC
	lea	rcx, QWORD PTR par$4[rdx]
	jmp	??1?$basic_string@DU?$char_traits@D@std@@V?$allocator@D@2@@std@@QEAA@XZ ; std::basic_string<char,std::char_traits<char>,std::allocator<char> >::~basic_string<char,std::char_traits<char>,std::allocator<char> >
main$dtor$2 ENDP
text$x	ENDS
;	COMDAT text$x
text$x	SEGMENT
$T1 = 32
prime_limit$1$ = 36
time_limit$1$ = 40
$T2 = 48
$T3 = 48
par$4 = 80
cmd$5 = 112
arg$6 = 144
_Eptr$7 = 176
_Eptr$8 = 184
szErr$9 = 192
argc$ = 272
argv$ = 280
tv2238 = 288
i$1$ = 296
main$dtor$3 PROC
	lea	rcx, QWORD PTR $T3[rdx]
	jmp	??1?$basic_string@DU?$char_traits@D@std@@V?$allocator@D@2@@std@@QEAA@XZ ; std::basic_string<char,std::char_traits<char>,std::allocator<char> >::~basic_string<char,std::char_traits<char>,std::allocator<char> >
main$dtor$3 ENDP
text$x	ENDS
;	COMDAT text$x
text$x	SEGMENT
$T1 = 32
prime_limit$1$ = 36
time_limit$1$ = 40
$T2 = 48
$T3 = 48
par$4 = 80
cmd$5 = 112
arg$6 = 144
_Eptr$7 = 176
_Eptr$8 = 184
szErr$9 = 192
argc$ = 272
argv$ = 280
tv2238 = 288
i$1$ = 296
main$dtor$4 PROC
	lea	rcx, QWORD PTR $T2[rdx]
	jmp	??1?$basic_string@DU?$char_traits@D@std@@V?$allocator@D@2@@std@@QEAA@XZ ; std::basic_string<char,std::char_traits<char>,std::allocator<char> >::~basic_string<char,std::char_traits<char>,std::allocator<char> >
main$dtor$4 ENDP
text$x	ENDS
;	COMDAT text$x
text$x	SEGMENT
$T1 = 32
prime_limit$1$ = 36
time_limit$1$ = 40
$T2 = 48
$T3 = 48
par$4 = 80
cmd$5 = 112
arg$6 = 144
_Eptr$7 = 176
_Eptr$8 = 184
szErr$9 = 192
argc$ = 272
argv$ = 280
tv2238 = 288
i$1$ = 296
main$catch$22 PROC
; File D:\myProjects\projects.cpp\sieve\src\primeSieve.cpp
; Line 79
	mov	QWORD PTR [rsp+16], rdx
	push	rbp
	sub	rsp, 32					; 00000020H
	mov	rbp, rdx
__catch$main$0:
; Line 80
	mov	rdx, QWORD PTR szErr$9[rbp]
	mov	rcx, QWORD PTR __imp_?cerr@std@@3V?$basic_ostream@DU?$char_traits@D@std@@@1@A
	call	??$?6U?$char_traits@D@std@@@std@@YAAEAV?$basic_ostream@DU?$char_traits@D@std@@@0@AEAV10@PEBD@Z ; std::operator<<<std::char_traits<char> >
	npad	1
; Line 81
	mov	rax, 0
	add	rsp, 32					; 00000020H
	pop	rbp
	ret	0
	int	3
main$catch$22 ENDP
text$x	ENDS
;	COMDAT text$x
text$x	SEGMENT
$T1 = 32
prime_limit$1$ = 36
time_limit$1$ = 40
$T2 = 48
$T3 = 48
par$4 = 80
cmd$5 = 112
arg$6 = 144
_Eptr$7 = 176
_Eptr$8 = 184
szErr$9 = 192
argc$ = 272
argv$ = 280
tv2238 = 288
i$1$ = 296
main$catch$23 PROC
; Line 83
	mov	QWORD PTR [rsp+16], rdx
	push	rbp
	sub	rsp, 32					; 00000020H
	mov	rbp, rdx
__catch$main$1:
; Line 84
	lea	rdx, OFFSET FLAT:??_C@_0BE@CEADDODL@unhandled?5exception@
	mov	rcx, QWORD PTR __imp_?cerr@std@@3V?$basic_ostream@DU?$char_traits@D@std@@@1@A
	call	??$?6U?$char_traits@D@std@@@std@@YAAEAV?$basic_ostream@DU?$char_traits@D@std@@@0@AEAV10@PEBD@Z ; std::operator<<<std::char_traits<char> >
	npad	1
; Line 85
	mov	rax, 0
	add	rsp, 32					; 00000020H
	pop	rbp
	ret	0
	int	3
main$catch$23 ENDP
text$x	ENDS
; Function compile flags: /Ogtpy
;	COMDAT text$x
text$x	SEGMENT
$T1 = 32
prime_limit$1$ = 36
time_limit$1$ = 40
$T2 = 48
$T3 = 48
par$4 = 80
cmd$5 = 112
arg$6 = 144
_Eptr$7 = 176
_Eptr$8 = 184
szErr$9 = 192
argc$ = 272
argv$ = 280
tv2238 = 288
i$1$ = 296
main$dtor$0 PROC
	lea	rcx, QWORD PTR arg$6[rdx]
	jmp	??1?$basic_string@DU?$char_traits@D@std@@V?$allocator@D@2@@std@@QEAA@XZ ; std::basic_string<char,std::char_traits<char>,std::allocator<char> >::~basic_string<char,std::char_traits<char>,std::allocator<char> >
main$dtor$0 ENDP
text$x	ENDS
; Function compile flags: /Ogtpy
;	COMDAT text$x
text$x	SEGMENT
$T1 = 32
prime_limit$1$ = 36
time_limit$1$ = 40
$T2 = 48
$T3 = 48
par$4 = 80
cmd$5 = 112
arg$6 = 144
_Eptr$7 = 176
_Eptr$8 = 184
szErr$9 = 192
argc$ = 272
argv$ = 280
tv2238 = 288
i$1$ = 296
main$dtor$1 PROC
	lea	rcx, QWORD PTR cmd$5[rdx]
	jmp	??1?$basic_string@DU?$char_traits@D@std@@V?$allocator@D@2@@std@@QEAA@XZ ; std::basic_string<char,std::char_traits<char>,std::allocator<char> >::~basic_string<char,std::char_traits<char>,std::allocator<char> >
main$dtor$1 ENDP
text$x	ENDS
; Function compile flags: /Ogtpy
;	COMDAT text$x
text$x	SEGMENT
$T1 = 32
prime_limit$1$ = 36
time_limit$1$ = 40
$T2 = 48
$T3 = 48
par$4 = 80
cmd$5 = 112
arg$6 = 144
_Eptr$7 = 176
_Eptr$8 = 184
szErr$9 = 192
argc$ = 272
argv$ = 280
tv2238 = 288
i$1$ = 296
main$dtor$2 PROC
	lea	rcx, QWORD PTR par$4[rdx]
	jmp	??1?$basic_string@DU?$char_traits@D@std@@V?$allocator@D@2@@std@@QEAA@XZ ; std::basic_string<char,std::char_traits<char>,std::allocator<char> >::~basic_string<char,std::char_traits<char>,std::allocator<char> >
main$dtor$2 ENDP
text$x	ENDS
; Function compile flags: /Ogtpy
;	COMDAT text$x
text$x	SEGMENT
$T1 = 32
prime_limit$1$ = 36
time_limit$1$ = 40
$T2 = 48
$T3 = 48
par$4 = 80
cmd$5 = 112
arg$6 = 144
_Eptr$7 = 176
_Eptr$8 = 184
szErr$9 = 192
argc$ = 272
argv$ = 280
tv2238 = 288
i$1$ = 296
main$dtor$3 PROC
	lea	rcx, QWORD PTR $T3[rdx]
	jmp	??1?$basic_string@DU?$char_traits@D@std@@V?$allocator@D@2@@std@@QEAA@XZ ; std::basic_string<char,std::char_traits<char>,std::allocator<char> >::~basic_string<char,std::char_traits<char>,std::allocator<char> >
main$dtor$3 ENDP
text$x	ENDS
; Function compile flags: /Ogtpy
;	COMDAT text$x
text$x	SEGMENT
$T1 = 32
prime_limit$1$ = 36
time_limit$1$ = 40
$T2 = 48
$T3 = 48
par$4 = 80
cmd$5 = 112
arg$6 = 144
_Eptr$7 = 176
_Eptr$8 = 184
szErr$9 = 192
argc$ = 272
argv$ = 280
tv2238 = 288
i$1$ = 296
main$dtor$4 PROC
	lea	rcx, QWORD PTR $T2[rdx]
	jmp	??1?$basic_string@DU?$char_traits@D@std@@V?$allocator@D@2@@std@@QEAA@XZ ; std::basic_string<char,std::char_traits<char>,std::allocator<char> >::~basic_string<char,std::char_traits<char>,std::allocator<char> >
main$dtor$4 ENDP
text$x	ENDS
; Function compile flags: /Ogtpy
;	COMDAT text$x
text$x	SEGMENT
$T1 = 32
prime_limit$1$ = 36
time_limit$1$ = 40
$T2 = 48
$T3 = 48
par$4 = 80
cmd$5 = 112
arg$6 = 144
_Eptr$7 = 176
_Eptr$8 = 184
szErr$9 = 192
argc$ = 272
argv$ = 280
tv2238 = 288
i$1$ = 296
main$catch$22 PROC
; Line 79
	mov	QWORD PTR [rsp+16], rdx
	push	rbp
	sub	rsp, 32					; 00000020H
	mov	rbp, rdx
__catch$main$0:
; Line 80
	mov	rdx, QWORD PTR szErr$9[rbp]
	mov	rcx, QWORD PTR __imp_?cerr@std@@3V?$basic_ostream@DU?$char_traits@D@std@@@1@A
	call	??$?6U?$char_traits@D@std@@@std@@YAAEAV?$basic_ostream@DU?$char_traits@D@std@@@0@AEAV10@PEBD@Z ; std::operator<<<std::char_traits<char> >
	npad	1
; Line 81
	mov	rax, 0
	add	rsp, 32					; 00000020H
	pop	rbp
	ret	0
	int	3
main$catch$22 ENDP
text$x	ENDS
; Function compile flags: /Ogtpy
;	COMDAT text$x
text$x	SEGMENT
$T1 = 32
prime_limit$1$ = 36
time_limit$1$ = 40
$T2 = 48
$T3 = 48
par$4 = 80
cmd$5 = 112
arg$6 = 144
_Eptr$7 = 176
_Eptr$8 = 184
szErr$9 = 192
argc$ = 272
argv$ = 280
tv2238 = 288
i$1$ = 296
main$catch$23 PROC
; Line 83
	mov	QWORD PTR [rsp+16], rdx
	push	rbp
	sub	rsp, 32					; 00000020H
	mov	rbp, rdx
__catch$main$1:
; Line 84
	lea	rdx, OFFSET FLAT:??_C@_0BE@CEADDODL@unhandled?5exception@
	mov	rcx, QWORD PTR __imp_?cerr@std@@3V?$basic_ostream@DU?$char_traits@D@std@@@1@A
	call	??$?6U?$char_traits@D@std@@@std@@YAAEAV?$basic_ostream@DU?$char_traits@D@std@@@0@AEAV10@PEBD@Z ; std::operator<<<std::char_traits<char> >
	npad	1
; Line 85
	mov	rax, 0
	add	rsp, 32					; 00000020H
	pop	rbp
	ret	0
	int	3
main$catch$23 ENDP
text$x	ENDS
; Function compile flags: /Ogtpy
;	COMDAT ??$endl@DU?$char_traits@D@std@@@std@@YAAEAV?$basic_ostream@DU?$char_traits@D@std@@@0@AEAV10@@Z
_TEXT	SEGMENT
_Ostr$ = 48
??$endl@DU?$char_traits@D@std@@@std@@YAAEAV?$basic_ostream@DU?$char_traits@D@std@@@0@AEAV10@@Z PROC ; std::endl<char,std::char_traits<char> >, COMDAT
; File C:\myPrograms\vs2019\VC\Tools\MSVC\14.29.30133\include\ostream
; Line 978
$LN4:
	push	rbx
	sub	rsp, 32					; 00000020H
; Line 979
	mov	rax, QWORD PTR [rcx]
	mov	rbx, rcx
	mov	dl, 10
	movsxd	rcx, DWORD PTR [rax+4]
	add	rcx, rbx
	call	QWORD PTR __imp_?widen@?$basic_ios@DU?$char_traits@D@std@@@std@@QEBADD@Z
	movzx	edx, al
	mov	rcx, rbx
	call	QWORD PTR __imp_?put@?$basic_ostream@DU?$char_traits@D@std@@@std@@QEAAAEAV12@D@Z
; Line 980
	mov	rcx, rbx
	call	QWORD PTR __imp_?flush@?$basic_ostream@DU?$char_traits@D@std@@@std@@QEAAAEAV12@XZ
; Line 981
	mov	rax, rbx
; Line 982
	add	rsp, 32					; 00000020H
	pop	rbx
	ret	0
??$endl@DU?$char_traits@D@std@@@std@@YAAEAV?$basic_ostream@DU?$char_traits@D@std@@@0@AEAV10@@Z ENDP ; std::endl<char,std::char_traits<char> >
_TEXT	ENDS
; Function compile flags: /Ogtpy
;	COMDAT ??$?6U?$char_traits@D@std@@@std@@YAAEAV?$basic_ostream@DU?$char_traits@D@std@@@0@AEAV10@PEBD@Z
_TEXT	SEGMENT
_Ok$ = 32
_Ostr$ = 96
_Val$ = 104
_State$ = 112
??$?6U?$char_traits@D@std@@@std@@YAAEAV?$basic_ostream@DU?$char_traits@D@std@@@0@AEAV10@PEBD@Z PROC ; std::operator<<<std::char_traits<char> >, COMDAT
; File C:\myPrograms\vs2019\VC\Tools\MSVC\14.29.30133\include\ostream
; Line 734
$LN99:
	mov	QWORD PTR [rsp+16], rbx
	mov	QWORD PTR [rsp+8], rcx
	push	rsi
	push	rdi
	push	r12
	push	r14
	push	r15
	sub	rsp, 48					; 00000030H
	mov	r15, rdx
	mov	rsi, rcx
; Line 738
	xor	ebx, ebx
	mov	DWORD PTR _State$[rsp], ebx
; File C:\myPrograms\vs2019\VC\Tools\MSVC\14.29.30133\include\xstring
; Line 412
	mov	r14, -1
	npad	7
$LL92@operator:
	inc	r14
	cmp	BYTE PTR [rdx+r14], bl
	jne	SHORT $LL92@operator
; File C:\myPrograms\vs2019\VC\Tools\MSVC\14.29.30133\include\ostream
; Line 740
	mov	rcx, QWORD PTR [rcx]
	movsxd	rax, DWORD PTR [rcx+4]
; File C:\myPrograms\vs2019\VC\Tools\MSVC\14.29.30133\include\xiosbase
; Line 363
	mov	rdi, QWORD PTR [rax+rsi+40]
; File C:\myPrograms\vs2019\VC\Tools\MSVC\14.29.30133\include\ostream
; Line 740
	test	rdi, rdi
	jle	SHORT $LN17@operator
	cmp	rdi, r14
	jle	SHORT $LN17@operator
	sub	rdi, r14
	jmp	SHORT $LN18@operator
$LN17@operator:
	xor	edi, edi
$LN18@operator:
; Line 71
	mov	r12, rsi
	mov	QWORD PTR _Ok$[rsp], rsi
; File C:\myPrograms\vs2019\VC\Tools\MSVC\14.29.30133\include\ios
; Line 80
	mov	r8, QWORD PTR [rax+rsi+72]
	mov	rdx, rcx
; File C:\myPrograms\vs2019\VC\Tools\MSVC\14.29.30133\include\ostream
; Line 73
	test	r8, r8
	je	SHORT $LN39@operator
; Line 74
	mov	rax, QWORD PTR [r8]
	mov	rcx, r8
	call	QWORD PTR [rax+8]
	mov	rcx, QWORD PTR [rsi]
	mov	rdx, rcx
$LN39@operator:
; Line 93
	movsxd	rax, DWORD PTR [rcx+4]
; File C:\myPrograms\vs2019\VC\Tools\MSVC\14.29.30133\include\xiosbase
; Line 295
	cmp	DWORD PTR [rax+rsi+16], 0
; File C:\myPrograms\vs2019\VC\Tools\MSVC\14.29.30133\include\ostream
; Line 93
	je	SHORT $LN33@operator
; Line 94
	xor	al, al
; Line 95
	jmp	SHORT $LN95@operator
$LN33@operator:
; File C:\myPrograms\vs2019\VC\Tools\MSVC\14.29.30133\include\ios
; Line 70
	mov	rax, QWORD PTR [rax+rsi+80]
; File C:\myPrograms\vs2019\VC\Tools\MSVC\14.29.30133\include\ostream
; Line 99
	test	rax, rax
	je	SHORT $LN35@operator
	cmp	rax, rsi
	je	SHORT $LN35@operator
; Line 104
	mov	rcx, rax
	call	QWORD PTR __imp_?flush@?$basic_ostream@DU?$char_traits@D@std@@@std@@QEAAAEAV12@XZ
; Line 105
	mov	rcx, QWORD PTR [rsi]
	movsxd	rax, DWORD PTR [rcx+4]
; File C:\myPrograms\vs2019\VC\Tools\MSVC\14.29.30133\include\xiosbase
; Line 295
	cmp	DWORD PTR [rax+rsi+16], 0
	sete	al
; File C:\myPrograms\vs2019\VC\Tools\MSVC\14.29.30133\include\ostream
; Line 105
	mov	rdx, rcx
	jmp	SHORT $LN95@operator
$LN35@operator:
; Line 100
	mov	al, 1
$LN95@operator:
; Line 106
	mov	BYTE PTR _Ok$[rsp+8], al
; Line 743
	test	al, al
	jne	SHORT $LN8@operator
; Line 744
	mov	ebx, 4
; Line 745
	jmp	$LN22@operator
$LN8@operator:
; Line 747
	movsxd	rax, DWORD PTR [rcx+4]
; File C:\myPrograms\vs2019\VC\Tools\MSVC\14.29.30133\include\xiosbase
; Line 326
	mov	ecx, DWORD PTR [rax+rsi+24]
; File C:\myPrograms\vs2019\VC\Tools\MSVC\14.29.30133\include\ostream
; Line 747
	and	ecx, 448				; 000001c0H
	cmp	ecx, 64					; 00000040H
	je	SHORT $LN87@operator
	npad	4
$LL4@operator:
; Line 748
	test	rdi, rdi
	jle	SHORT $LN89@operator
; Line 749
	mov	rax, QWORD PTR [rsi]
	movsxd	rcx, DWORD PTR [rax+4]
	movzx	edx, BYTE PTR [rcx+rsi+88]
	mov	rcx, QWORD PTR [rcx+rsi+72]
	call	QWORD PTR __imp_?sputc@?$basic_streambuf@DU?$char_traits@D@std@@@std@@QEAAHD@Z
	cmp	eax, -1
	je	SHORT $LN96@operator
; Line 748
	dec	rdi
	jmp	SHORT $LL4@operator
$LN89@operator:
; Line 756
	mov	rdx, QWORD PTR [rsi]
$LN87@operator:
	movsxd	rax, DWORD PTR [rdx+4]
	mov	r8, r14
	mov	rdx, r15
	mov	rcx, QWORD PTR [rax+rsi+72]
	call	QWORD PTR __imp_?sputn@?$basic_streambuf@DU?$char_traits@D@std@@@std@@QEAA_JPEBD_J@Z
	cmp	rax, r14
	jne	SHORT $LN96@operator
$LL93@operator:
; Line 761
	test	rdi, rdi
	jle	SHORT $LN6@operator
; Line 762
	mov	rax, QWORD PTR [rsi]
	movsxd	rcx, DWORD PTR [rax+4]
	movzx	edx, BYTE PTR [rcx+rsi+88]
	mov	rcx, QWORD PTR [rcx+rsi+72]
	call	QWORD PTR __imp_?sputc@?$basic_streambuf@DU?$char_traits@D@std@@@std@@QEAAHD@Z
	cmp	eax, -1
	je	SHORT $LN96@operator
; Line 761
	dec	rdi
	jmp	SHORT $LL93@operator
$LN96@operator:
; Line 769
	mov	ebx, 4
	mov	DWORD PTR _State$[rsp], ebx
$LN6@operator:
	mov	rax, QWORD PTR [rsi]
	movsxd	rcx, DWORD PTR [rax+4]
; File C:\myPrograms\vs2019\VC\Tools\MSVC\14.29.30133\include\xiosbase
; Line 368
	mov	QWORD PTR [rcx+rsi+40], 0
; File C:\myPrograms\vs2019\VC\Tools\MSVC\14.29.30133\include\ostream
	jmp	SHORT $LN22@operator
$LN23@operator:
; File C:\myPrograms\vs2019\VC\Tools\MSVC\14.29.30133\include\ios
	mov	rsi, QWORD PTR _Ostr$[rsp]
	mov	ebx, DWORD PTR _State$[rsp]
	mov	r12, QWORD PTR _Ok$[rsp]
$LN22@operator:
; File C:\myPrograms\vs2019\VC\Tools\MSVC\14.29.30133\include\ostream
; Line 773
	mov	rax, QWORD PTR [rsi]
	movsxd	rcx, DWORD PTR [rax+4]
	add	rcx, rsi
	xor	r8d, r8d
	mov	edx, ebx
	call	QWORD PTR __imp_?setstate@?$basic_ios@DU?$char_traits@D@std@@@std@@QEAAXH_N@Z
	npad	1
; Line 113
	call	?uncaught_exception@std@@YA_NXZ		; std::uncaught_exception
; Line 118
	test	al, al
	jne	SHORT $LN72@operator
; Line 119
	mov	rcx, r12
	call	QWORD PTR __imp_?_Osfx@?$basic_ostream@DU?$char_traits@D@std@@@std@@QEAAXXZ
	npad	1
$LN72@operator:
; Line 79
	mov	rax, QWORD PTR [r12]
	movsxd	rcx, DWORD PTR [rax+4]
; File C:\myPrograms\vs2019\VC\Tools\MSVC\14.29.30133\include\ios
; Line 80
	mov	rcx, QWORD PTR [rcx+r12+72]
; File C:\myPrograms\vs2019\VC\Tools\MSVC\14.29.30133\include\ostream
; Line 80
	test	rcx, rcx
	je	SHORT $LN76@operator
; Line 81
	mov	rax, QWORD PTR [rcx]
	call	QWORD PTR [rax+16]
	npad	1
$LN76@operator:
; Line 774
	mov	rax, rsi
; Line 775
	mov	rbx, QWORD PTR [rsp+104]
	add	rsp, 48					; 00000030H
	pop	r15
	pop	r14
	pop	r12
	pop	rdi
	pop	rsi
	ret	0
??$?6U?$char_traits@D@std@@@std@@YAAEAV?$basic_ostream@DU?$char_traits@D@std@@@0@AEAV10@PEBD@Z ENDP ; std::operator<<<std::char_traits<char> >
_TEXT	ENDS
;	COMDAT text$x
text$x	SEGMENT
_Ok$ = 32
_Ostr$ = 96
_Val$ = 104
_State$ = 112
?dtor$1@?0???$?6U?$char_traits@D@std@@@std@@YAAEAV?$basic_ostream@DU?$char_traits@D@std@@@0@AEAV10@PEBD@Z@4HA PROC ; `std::operator<<<std::char_traits<char> >'::`1'::dtor$1
	lea	rcx, QWORD PTR _Ok$[rdx]
	jmp	??1_Sentry_base@?$basic_ostream@DU?$char_traits@D@std@@@std@@QEAA@XZ ; std::basic_ostream<char,std::char_traits<char> >::_Sentry_base::~_Sentry_base
?dtor$1@?0???$?6U?$char_traits@D@std@@@std@@YAAEAV?$basic_ostream@DU?$char_traits@D@std@@@0@AEAV10@PEBD@Z@4HA ENDP ; `std::operator<<<std::char_traits<char> >'::`1'::dtor$1
text$x	ENDS
;	COMDAT text$x
text$x	SEGMENT
_Ok$ = 32
_Ostr$ = 96
_Val$ = 104
_State$ = 112
?dtor$0@?0???$?6U?$char_traits@D@std@@@std@@YAAEAV?$basic_ostream@DU?$char_traits@D@std@@@0@AEAV10@PEBD@Z@4HA PROC ; `std::operator<<<std::char_traits<char> >'::`1'::dtor$0
	lea	rcx, QWORD PTR _Ok$[rdx]
	jmp	??1sentry@?$basic_ostream@DU?$char_traits@D@std@@@std@@QEAA@XZ ; std::basic_ostream<char,std::char_traits<char> >::sentry::~sentry
?dtor$0@?0???$?6U?$char_traits@D@std@@@std@@YAAEAV?$basic_ostream@DU?$char_traits@D@std@@@0@AEAV10@PEBD@Z@4HA ENDP ; `std::operator<<<std::char_traits<char> >'::`1'::dtor$0
text$x	ENDS
;	COMDAT text$x
text$x	SEGMENT
_Ok$ = 32
_Ostr$ = 96
_Val$ = 104
_State$ = 112
?catch$4@?0???$?6U?$char_traits@D@std@@@std@@YAAEAV?$basic_ostream@DU?$char_traits@D@std@@@0@AEAV10@PEBD@Z@4HA PROC ; `std::operator<<<std::char_traits<char> >'::`1'::catch$4
; Line 770
	mov	QWORD PTR [rsp+16], rdx
	push	rbp
	sub	rsp, 32					; 00000020H
	mov	rbp, rdx
__catch$??$?6U?$char_traits@D@std@@@std@@YAAEAV?$basic_ostream@DU?$char_traits@D@std@@@0@AEAV10@PEBD@Z$0:
	mov	rdx, QWORD PTR _Ostr$[rbp]
	mov	rax, QWORD PTR [rdx]
	movsxd	rcx, DWORD PTR [rax+4]
	add	rcx, rdx
	mov	r8b, 1
	mov	edx, 4
	call	QWORD PTR __imp_?setstate@?$basic_ios@DU?$char_traits@D@std@@@std@@QEAAXH_N@Z
	npad	1
	mov	rax, 0
	add	rsp, 32					; 00000020H
	pop	rbp
	ret	0
	int	3
?catch$4@?0???$?6U?$char_traits@D@std@@@std@@YAAEAV?$basic_ostream@DU?$char_traits@D@std@@@0@AEAV10@PEBD@Z@4HA ENDP ; `std::operator<<<std::char_traits<char> >'::`1'::catch$4
text$x	ENDS
; Function compile flags: /Ogtpy
;	COMDAT text$x
text$x	SEGMENT
_Ok$ = 32
_Ostr$ = 96
_Val$ = 104
_State$ = 112
?dtor$1@?0???$?6U?$char_traits@D@std@@@std@@YAAEAV?$basic_ostream@DU?$char_traits@D@std@@@0@AEAV10@PEBD@Z@4HA PROC ; `std::operator<<<std::char_traits<char> >'::`1'::dtor$1
	lea	rcx, QWORD PTR _Ok$[rdx]
	jmp	??1_Sentry_base@?$basic_ostream@DU?$char_traits@D@std@@@std@@QEAA@XZ ; std::basic_ostream<char,std::char_traits<char> >::_Sentry_base::~_Sentry_base
?dtor$1@?0???$?6U?$char_traits@D@std@@@std@@YAAEAV?$basic_ostream@DU?$char_traits@D@std@@@0@AEAV10@PEBD@Z@4HA ENDP ; `std::operator<<<std::char_traits<char> >'::`1'::dtor$1
text$x	ENDS
; Function compile flags: /Ogtpy
;	COMDAT text$x
text$x	SEGMENT
_Ok$ = 32
_Ostr$ = 96
_Val$ = 104
_State$ = 112
?dtor$0@?0???$?6U?$char_traits@D@std@@@std@@YAAEAV?$basic_ostream@DU?$char_traits@D@std@@@0@AEAV10@PEBD@Z@4HA PROC ; `std::operator<<<std::char_traits<char> >'::`1'::dtor$0
	lea	rcx, QWORD PTR _Ok$[rdx]
	jmp	??1sentry@?$basic_ostream@DU?$char_traits@D@std@@@std@@QEAA@XZ ; std::basic_ostream<char,std::char_traits<char> >::sentry::~sentry
?dtor$0@?0???$?6U?$char_traits@D@std@@@std@@YAAEAV?$basic_ostream@DU?$char_traits@D@std@@@0@AEAV10@PEBD@Z@4HA ENDP ; `std::operator<<<std::char_traits<char> >'::`1'::dtor$0
text$x	ENDS
; Function compile flags: /Ogtpy
;	COMDAT text$x
text$x	SEGMENT
_Ok$ = 32
_Ostr$ = 96
_Val$ = 104
_State$ = 112
?catch$4@?0???$?6U?$char_traits@D@std@@@std@@YAAEAV?$basic_ostream@DU?$char_traits@D@std@@@0@AEAV10@PEBD@Z@4HA PROC ; `std::operator<<<std::char_traits<char> >'::`1'::catch$4
; Line 770
	mov	QWORD PTR [rsp+16], rdx
	push	rbp
	sub	rsp, 32					; 00000020H
	mov	rbp, rdx
__catch$??$?6U?$char_traits@D@std@@@std@@YAAEAV?$basic_ostream@DU?$char_traits@D@std@@@0@AEAV10@PEBD@Z$0:
	mov	rdx, QWORD PTR _Ostr$[rbp]
	mov	rax, QWORD PTR [rdx]
	movsxd	rcx, DWORD PTR [rax+4]
	add	rcx, rdx
	mov	r8b, 1
	mov	edx, 4
	call	QWORD PTR __imp_?setstate@?$basic_ios@DU?$char_traits@D@std@@@std@@QEAAXH_N@Z
	npad	1
	mov	rax, 0
	add	rsp, 32					; 00000020H
	pop	rbp
	ret	0
	int	3
?catch$4@?0???$?6U?$char_traits@D@std@@@std@@YAAEAV?$basic_ostream@DU?$char_traits@D@std@@@0@AEAV10@PEBD@Z@4HA ENDP ; `std::operator<<<std::char_traits<char> >'::`1'::catch$4
text$x	ENDS
; Function compile flags: /Ogtpy
;	COMDAT ?time_sieve@@YAXII_N@Z
_TEXT	SEGMENT
P$ = 32
prime_limit$ = 112
time_limit$ = 120
show_primes$ = 128
?time_sieve@@YAXII_N@Z PROC				; time_sieve, COMDAT
; File D:\myProjects\projects.cpp\sieve\src\primeSieve.cpp
; Line 16
$LN82:
	mov	QWORD PTR [rsp+8], rbx
	mov	QWORD PTR [rsp+16], rbp
	mov	QWORD PTR [rsp+32], rsi
	mov	BYTE PTR [rsp+24], r8b
	push	rdi
	push	r12
	push	r13
	push	r14
	push	r15
	sub	rsp, 64					; 00000040H
	mov	edi, edx
	mov	r15d, ecx
; Line 17
	lea	rcx, QWORD PTR P$[rsp]
	call	??0Sieve@@QEAA@XZ			; Sieve::Sieve
	npad	1
; Line 19
	xor	ebp, ebp
; File C:\myPrograms\vs2019\VC\Tools\MSVC\14.29.30133\include\chrono
; Line 705
	call	_Query_perf_frequency
; Line 706
	call	_Query_perf_counter
; Line 705
	call	_Query_perf_frequency
	mov	rbx, rax
; Line 706
	call	_Query_perf_counter
; Line 713
	cdq
	idiv	rbx
	imul	r12, rax, 1000000000			; 3b9aca00H
; Line 714
	imul	rax, rdx, 1000000000			; 3b9aca00H
	cdq
	idiv	rbx
; Line 715
	add	r12, rax
	mov	r13, 4835703278458516699		; 431bde82d7b634dbH
	npad	1
$LL4@time_sieve:
; File D:\myProjects\projects.cpp\sieve\src\primeSieve.cpp
; Line 26
	lea	rcx, QWORD PTR P$[rsp]
	call	?empty@Sieve@@QEAAXXZ			; Sieve::empty
; Line 27
	mov	edx, r15d
	lea	rcx, QWORD PTR P$[rsp]
	call	?init@Sieve@@QEAAXI@Z			; Sieve::init
; Line 28
	lea	rcx, QWORD PTR P$[rsp]
	call	?sieve2@Sieve@@QEAAHXZ			; Sieve::sieve2
	mov	r14d, eax
; Line 29
	inc	ebp
; File C:\myPrograms\vs2019\VC\Tools\MSVC\14.29.30133\include\chrono
; Line 705
	call	_Query_perf_frequency
	mov	rbx, rax
; Line 706
	call	_Query_perf_counter
; Line 713
	cdq
	idiv	rbx
	imul	rcx, rax, 1000000000			; 3b9aca00H
; Line 714
	imul	rax, rdx, 1000000000			; 3b9aca00H
	cdq
	idiv	rbx
; Line 715
	add	rcx, rax
; Line 314
	sub	rcx, r12
; Line 124
	mov	rax, r13
	imul	rcx
	mov	rsi, rdx
	sar	rsi, 18
	mov	rax, rsi
	shr	rax, 63					; 0000003fH
	add	rsi, rax
; File D:\myProjects\projects.cpp\sieve\src\primeSieve.cpp
; Line 31
	mov	edx, r14d
	lea	rcx, QWORD PTR P$[rsp]
	call	?validate@Sieve@@QEAA_NH@Z		; Sieve::validate
	test	al, al
	je	SHORT $LN5@time_sieve
	cmp	esi, edi
	jb	SHORT $LL4@time_sieve
$LN5@time_sieve:
; Line 37
	lea	rdx, OFFSET FLAT:?dec@std@@YAAEAVios_base@1@AEAV21@@Z ; std::dec
	mov	rcx, QWORD PTR __imp_?cout@std@@3V?$basic_ostream@DU?$char_traits@D@std@@@1@A
	call	QWORD PTR __imp_??6?$basic_ostream@DU?$char_traits@D@std@@@std@@QEAAAEAV01@P6AAEAVios_base@1@AEAV21@@Z@Z
	mov	rcx, rax
	lea	rdx, OFFSET FLAT:??_C@_08DBACIOND@passes?3?5@
	call	??$?6U?$char_traits@D@std@@@std@@YAAEAV?$basic_ostream@DU?$char_traits@D@std@@@0@AEAV10@PEBD@Z ; std::operator<<<std::char_traits<char> >
	mov	rcx, rax
	mov	edx, ebp
	call	QWORD PTR __imp_??6?$basic_ostream@DU?$char_traits@D@std@@@std@@QEAAAEAV01@I@Z
	mov	rcx, rax
	lea	rdx, OFFSET FLAT:??_C@_0P@PHNIAHAC@?5elapsed?5time?5@
	call	??$?6U?$char_traits@D@std@@@std@@YAAEAV?$basic_ostream@DU?$char_traits@D@std@@@0@AEAV10@PEBD@Z ; std::operator<<<std::char_traits<char> >
	mov	r8, rax
; File D:\myProjects\projects.cpp\sieve\headers\FFmt.h
; Line 18
	mov	rcx, QWORD PTR [rax]
	movsxd	rdx, DWORD PTR [rcx+4]
; File C:\myPrograms\vs2019\VC\Tools\MSVC\14.29.30133\include\xiosbase
; Line 343
	mov	ecx, DWORD PTR [rdx+rax+24]
; Line 344
	btr	ecx, 12
	bts	ecx, 13
	mov	DWORD PTR [rdx+rax+24], ecx
; File D:\myProjects\projects.cpp\sieve\headers\FFmt.h
; Line 19
	mov	rcx, QWORD PTR [rax]
	movsxd	rax, DWORD PTR [rcx+4]
; File C:\myPrograms\vs2019\VC\Tools\MSVC\14.29.30133\include\xiosbase
; Line 358
	mov	QWORD PTR [rax+r8+32], 4
; File D:\myProjects\projects.cpp\sieve\headers\FFmt.h
; Line 20
	mov	rax, QWORD PTR [r8]
	movsxd	rcx, DWORD PTR [rax+4]
; File C:\myPrograms\vs2019\VC\Tools\MSVC\14.29.30133\include\xiosbase
; Line 368
	mov	QWORD PTR [rcx+r8+40], 10
; File D:\myProjects\projects.cpp\sieve\src\primeSieve.cpp
; Line 37
	mov	edx, esi
	mov	rcx, r8
	call	QWORD PTR __imp_??6?$basic_ostream@DU?$char_traits@D@std@@@std@@QEAAAEAV01@I@Z
	mov	rcx, rax
	lea	rdx, OFFSET FLAT:??_C@_03KPBANJDJ@?5mS@
	call	??$?6U?$char_traits@D@std@@@std@@YAAEAV?$basic_ostream@DU?$char_traits@D@std@@@0@AEAV10@PEBD@Z ; std::operator<<<std::char_traits<char> >
	mov	rcx, rax
	lea	rdx, OFFSET FLAT:??_C@_0L@FJGKFKOH@?5avg?1pass?5@
	call	??$?6U?$char_traits@D@std@@@std@@YAAEAV?$basic_ostream@DU?$char_traits@D@std@@@0@AEAV10@PEBD@Z ; std::operator<<<std::char_traits<char> >
	mov	rdi, rax
; File D:\myProjects\projects.cpp\sieve\headers\FFmt.h
; Line 18
	mov	rcx, QWORD PTR [rax]
	movsxd	rdx, DWORD PTR [rcx+4]
; File C:\myPrograms\vs2019\VC\Tools\MSVC\14.29.30133\include\xiosbase
; Line 343
	mov	ecx, DWORD PTR [rdx+rax+24]
; Line 344
	btr	ecx, 12
	bts	ecx, 13
	mov	DWORD PTR [rdx+rax+24], ecx
; File D:\myProjects\projects.cpp\sieve\headers\FFmt.h
; Line 19
	mov	rcx, QWORD PTR [rax]
	movsxd	rdx, DWORD PTR [rcx+4]
; File C:\myPrograms\vs2019\VC\Tools\MSVC\14.29.30133\include\xiosbase
; Line 358
	mov	QWORD PTR [rdx+rax+32], 4
; File D:\myProjects\projects.cpp\sieve\headers\FFmt.h
; Line 20
	mov	rax, QWORD PTR [rax]
	movsxd	rcx, DWORD PTR [rax+4]
; File C:\myPrograms\vs2019\VC\Tools\MSVC\14.29.30133\include\xiosbase
; Line 368
	mov	QWORD PTR [rcx+rdi+40], 10
; File D:\myProjects\projects.cpp\sieve\src\primeSieve.cpp
; Line 37
	mov	edx, r14d
	lea	rcx, QWORD PTR P$[rsp]
	call	?validate@Sieve@@QEAA_NH@Z		; Sieve::validate
	movzx	ebx, al
	mov	ecx, esi
	xorps	xmm1, xmm1
	cvtsi2sd xmm1, rcx
	mov	ecx, ebp
	xorps	xmm0, xmm0
	cvtsi2sd xmm0, rcx
	divsd	xmm1, xmm0
	mov	rcx, rdi
	call	QWORD PTR __imp_??6?$basic_ostream@DU?$char_traits@D@std@@@std@@QEAAAEAV01@N@Z
	mov	rcx, rax
	lea	rdx, OFFSET FLAT:??_C@_03KPBANJDJ@?5mS@
	call	??$?6U?$char_traits@D@std@@@std@@YAAEAV?$basic_ostream@DU?$char_traits@D@std@@@0@AEAV10@PEBD@Z ; std::operator<<<std::char_traits<char> >
	mov	rcx, rax
	lea	rdx, OFFSET FLAT:??_C@_07OBLGNFJI@?5limit?5@
	call	??$?6U?$char_traits@D@std@@@std@@YAAEAV?$basic_ostream@DU?$char_traits@D@std@@@0@AEAV10@PEBD@Z ; std::operator<<<std::char_traits<char> >
	mov	rcx, rax
	mov	edx, r15d
	call	QWORD PTR __imp_??6?$basic_ostream@DU?$char_traits@D@std@@@std@@QEAAAEAV01@I@Z
	mov	rcx, rax
	lea	rdx, OFFSET FLAT:??_C@_07MOAKCJG@?5count?5@
	call	??$?6U?$char_traits@D@std@@@std@@YAAEAV?$basic_ostream@DU?$char_traits@D@std@@@0@AEAV10@PEBD@Z ; std::operator<<<std::char_traits<char> >
	mov	rcx, rax
	mov	edx, r14d
	call	QWORD PTR __imp_??6?$basic_ostream@DU?$char_traits@D@std@@@std@@QEAAAEAV01@H@Z
	mov	rcx, rax
	lea	rdx, OFFSET FLAT:??_C@_07OPANBOLF@?5valid?5@
	call	??$?6U?$char_traits@D@std@@@std@@YAAEAV?$basic_ostream@DU?$char_traits@D@std@@@0@AEAV10@PEBD@Z ; std::operator<<<std::char_traits<char> >
	mov	rcx, rax
	movzx	edx, bl
	call	QWORD PTR __imp_??6?$basic_ostream@DU?$char_traits@D@std@@@std@@QEAAAEAV01@_N@Z
	mov	rcx, rax
	lea	rdx, OFFSET FLAT:??$endl@DU?$char_traits@D@std@@@std@@YAAEAV?$basic_ostream@DU?$char_traits@D@std@@@0@AEAV10@@Z ; std::endl<char,std::char_traits<char> >
	call	QWORD PTR __imp_??6?$basic_ostream@DU?$char_traits@D@std@@@std@@QEAAAEAV01@P6AAEAV01@AEAV01@@Z@Z
; Line 44
	cmp	BYTE PTR show_primes$[rsp], 0
	je	SHORT $LN6@time_sieve
; Line 45
	lea	rdx, QWORD PTR P$[rsp]
	mov	rcx, QWORD PTR __imp_?cout@std@@3V?$basic_ostream@DU?$char_traits@D@std@@@1@A
	call	??6@YAAEAV?$basic_ostream@DU?$char_traits@D@std@@@std@@AEAV01@AEAVSieve@@@Z ; operator<<
	npad	1
$LN6@time_sieve:
; File D:\myProjects\projects.cpp\sieve\headers\tBitArray.h
; Line 32
	lea	rcx, QWORD PTR P$[rsp+16]
	call	?empty@tBitArray@@QEAAXXZ		; tBitArray::empty
	npad	1
; File D:\myProjects\projects.cpp\sieve\src\primeSieve.cpp
; Line 47
	mov	rbx, QWORD PTR [rsp+112]
	mov	rbp, QWORD PTR [rsp+120]
	mov	rsi, QWORD PTR [rsp+136]
	add	rsp, 64					; 00000040H
	pop	r15
	pop	r14
	pop	r13
	pop	r12
	pop	rdi
	ret	0
?time_sieve@@YAXII_N@Z ENDP				; time_sieve
_TEXT	ENDS
;	COMDAT text$x
text$x	SEGMENT
P$ = 32
prime_limit$ = 112
time_limit$ = 120
show_primes$ = 128
?dtor$0@?0??time_sieve@@YAXII_N@Z@4HA PROC		; `time_sieve'::`1'::dtor$0
	lea	rcx, QWORD PTR P$[rdx]
	jmp	??1Sieve@@QEAA@XZ
?dtor$0@?0??time_sieve@@YAXII_N@Z@4HA ENDP		; `time_sieve'::`1'::dtor$0
text$x	ENDS
; Function compile flags: /Ogtpy
;	COMDAT text$x
text$x	SEGMENT
P$ = 32
prime_limit$ = 112
time_limit$ = 120
show_primes$ = 128
?dtor$0@?0??time_sieve@@YAXII_N@Z@4HA PROC		; `time_sieve'::`1'::dtor$0
	lea	rcx, QWORD PTR P$[rdx]
	jmp	??1Sieve@@QEAA@XZ
?dtor$0@?0??time_sieve@@YAXII_N@Z@4HA ENDP		; `time_sieve'::`1'::dtor$0
text$x	ENDS
; Function compile flags: /Ogtpy
;	COMDAT ??$_Getvals@_W@?$time_get@_WV?$istreambuf_iterator@_WU?$char_traits@_W@std@@@std@@@std@@IEAAX_WAEBV_Locinfo@1@@Z
_TEXT	SEGMENT
$T1 = 32
this$ = 96
__formal$ = 104
_Lobj$ = 112
??$_Getvals@_W@?$time_get@_WV?$istreambuf_iterator@_WU?$char_traits@_W@std@@@std@@@std@@IEAAX_WAEBV_Locinfo@1@@Z PROC ; std::time_get<wchar_t,std::istreambuf_iterator<wchar_t,std::char_traits<wchar_t> > >::_Getvals<wchar_t>, COMDAT
; File C:\myPrograms\vs2019\VC\Tools\MSVC\14.29.30133\include\xloctime
; Line 173
$LN14:
	mov	QWORD PTR [rsp+8], rbx
	push	rdi
	sub	rsp, 80					; 00000050H
	mov	rdi, rcx
; Line 174
	lea	rdx, QWORD PTR $T1[rsp]
	mov	rcx, r8
	mov	rbx, r8
	call	QWORD PTR __imp_?_Getcvt@_Locinfo@std@@QEBA?AU_Cvtvec@@XZ
; Line 177
	mov	rcx, rbx
	movups	xmm0, XMMWORD PTR [rax]
	movups	XMMWORD PTR [rdi+44], xmm0
	movups	xmm1, XMMWORD PTR [rax+16]
	movups	XMMWORD PTR [rdi+60], xmm1
	movsd	xmm0, QWORD PTR [rax+32]
	movsd	QWORD PTR [rdi+76], xmm0
	mov	eax, DWORD PTR [rax+40]
	mov	DWORD PTR [rdi+84], eax
	call	QWORD PTR __imp_?_W_Getdays@_Locinfo@std@@QEBAPEBGXZ
	mov	rcx, rax
	call	?_Maklocwcs@std@@YAPEA_WPEB_W@Z		; std::_Maklocwcs
; Line 178
	mov	rcx, rbx
	mov	QWORD PTR [rdi+16], rax
	call	QWORD PTR __imp_?_W_Getmonths@_Locinfo@std@@QEBAPEBGXZ
	mov	rcx, rax
	call	?_Maklocwcs@std@@YAPEA_WPEB_W@Z		; std::_Maklocwcs
; File C:\myPrograms\vs2019\VC\Tools\MSVC\14.29.30133\include\xlocnum
; Line 93
	mov	edx, 2
; File C:\myPrograms\vs2019\VC\Tools\MSVC\14.29.30133\include\xloctime
; Line 178
	mov	QWORD PTR [rdi+24], rax
; File C:\myPrograms\vs2019\VC\Tools\MSVC\14.29.30133\include\xlocnum
; Line 93
	lea	ecx, QWORD PTR [rdx+11]
	call	QWORD PTR __imp_calloc
	mov	rcx, rax
; Line 95
	test	rax, rax
	je	SHORT $LN13@Getvals
; File C:\Program Files (x86)\Windows Kits\10\Include\10.0.19041.0\ucrt\wchar.h
; Line 236
	movups	xmm0, XMMWORD PTR ??_C@_1BK@MHIKGOKE@?$AA?3?$AAA?$AAM?$AA?3?$AAa?$AAm?$AA?3?$AAP?$AAM?$AA?3?$AAp?$AAm@
; File C:\myPrograms\vs2019\VC\Tools\MSVC\14.29.30133\include\xloctime
; Line 186
	mov	rbx, QWORD PTR [rsp+96]
; File C:\Program Files (x86)\Windows Kits\10\Include\10.0.19041.0\ucrt\wchar.h
; Line 236
	movsd	xmm1, QWORD PTR ??_C@_1BK@MHIKGOKE@?$AA?3?$AAA?$AAM?$AA?3?$AAa?$AAm?$AA?3?$AAP?$AAM?$AA?3?$AAp?$AAm@+16
	movups	XMMWORD PTR [rax], xmm0
	movsd	QWORD PTR [rax+16], xmm1
	movzx	eax, WORD PTR ??_C@_1BK@MHIKGOKE@?$AA?3?$AAA?$AAM?$AA?3?$AAa?$AAm?$AA?3?$AAP?$AAM?$AA?3?$AAp?$AAm@+24
	mov	WORD PTR [rcx+24], ax
; File C:\myPrograms\vs2019\VC\Tools\MSVC\14.29.30133\include\xloctime
; Line 180
	mov	QWORD PTR [rdi+32], rcx
; Line 186
	add	rsp, 80					; 00000050H
	pop	rdi
	ret	0
$LN13@Getvals:
; File C:\myPrograms\vs2019\VC\Tools\MSVC\14.29.30133\include\xlocnum
; Line 96
	call	?_Xbad_alloc@std@@YAXXZ			; std::_Xbad_alloc
	int	3
$LN11@Getvals:
??$_Getvals@_W@?$time_get@_WV?$istreambuf_iterator@_WU?$char_traits@_W@std@@@std@@@std@@IEAAX_WAEBV_Locinfo@1@@Z ENDP ; std::time_get<wchar_t,std::istreambuf_iterator<wchar_t,std::char_traits<wchar_t> > >::_Getvals<wchar_t>
_TEXT	ENDS
; Function compile flags: /Ogtpy
;	COMDAT ??$_Getvals@_W@?$time_get@DV?$istreambuf_iterator@DU?$char_traits@D@std@@@std@@@std@@IEAAX_WAEBV_Locinfo@1@@Z
_TEXT	SEGMENT
$T1 = 32
this$ = 96
__formal$ = 104
_Lobj$ = 112
??$_Getvals@_W@?$time_get@DV?$istreambuf_iterator@DU?$char_traits@D@std@@@std@@@std@@IEAAX_WAEBV_Locinfo@1@@Z PROC ; std::time_get<char,std::istreambuf_iterator<char,std::char_traits<char> > >::_Getvals<wchar_t>, COMDAT
; File C:\myPrograms\vs2019\VC\Tools\MSVC\14.29.30133\include\xloctime
; Line 173
$LN20:
	mov	QWORD PTR [rsp+8], rbx
	push	rdi
	sub	rsp, 80					; 00000050H
	mov	rdi, rcx
; Line 174
	lea	rdx, QWORD PTR $T1[rsp]
	mov	rcx, r8
	mov	rbx, r8
	call	QWORD PTR __imp_?_Getcvt@_Locinfo@std@@QEBA?AU_Cvtvec@@XZ
; Line 177
	mov	rcx, rbx
	movups	xmm0, XMMWORD PTR [rax]
	movups	XMMWORD PTR [rdi+44], xmm0
	movups	xmm1, XMMWORD PTR [rax+16]
	movups	XMMWORD PTR [rdi+60], xmm1
	movsd	xmm0, QWORD PTR [rax+32]
	movsd	QWORD PTR [rdi+76], xmm0
	mov	eax, DWORD PTR [rax+40]
	mov	DWORD PTR [rdi+84], eax
	call	QWORD PTR __imp_?_W_Getdays@_Locinfo@std@@QEBAPEBGXZ
	mov	rcx, rax
	call	?_Maklocwcs@std@@YAPEA_WPEB_W@Z		; std::_Maklocwcs
; Line 178
	mov	rcx, rbx
	mov	QWORD PTR [rdi+16], rax
	call	QWORD PTR __imp_?_W_Getmonths@_Locinfo@std@@QEBAPEBGXZ
	mov	rcx, rax
	call	?_Maklocwcs@std@@YAPEA_WPEB_W@Z		; std::_Maklocwcs
; File C:\myPrograms\vs2019\VC\Tools\MSVC\14.29.30133\include\xlocnum
; Line 93
	mov	edx, 2
; File C:\myPrograms\vs2019\VC\Tools\MSVC\14.29.30133\include\xloctime
; Line 178
	mov	QWORD PTR [rdi+24], rax
; File C:\myPrograms\vs2019\VC\Tools\MSVC\14.29.30133\include\xlocnum
; Line 93
	lea	ecx, QWORD PTR [rdx+11]
	call	QWORD PTR __imp_calloc
	mov	rcx, rax
; Line 95
	test	rax, rax
	je	SHORT $LN19@Getvals
; File C:\Program Files (x86)\Windows Kits\10\Include\10.0.19041.0\ucrt\wchar.h
; Line 236
	movups	xmm0, XMMWORD PTR ??_C@_1BK@MHIKGOKE@?$AA?3?$AAA?$AAM?$AA?3?$AAa?$AAm?$AA?3?$AAP?$AAM?$AA?3?$AAp?$AAm@
; File C:\myPrograms\vs2019\VC\Tools\MSVC\14.29.30133\include\xloctime
; Line 186
	mov	rbx, QWORD PTR [rsp+96]
; File C:\Program Files (x86)\Windows Kits\10\Include\10.0.19041.0\ucrt\wchar.h
; Line 236
	movsd	xmm1, QWORD PTR ??_C@_1BK@MHIKGOKE@?$AA?3?$AAA?$AAM?$AA?3?$AAa?$AAm?$AA?3?$AAP?$AAM?$AA?3?$AAp?$AAm@+16
	movups	XMMWORD PTR [rax], xmm0
	movsd	QWORD PTR [rax+16], xmm1
	movzx	eax, WORD PTR ??_C@_1BK@MHIKGOKE@?$AA?3?$AAA?$AAM?$AA?3?$AAa?$AAm?$AA?3?$AAP?$AAM?$AA?3?$AAp?$AAm@+24
	mov	WORD PTR [rcx+24], ax
; File C:\myPrograms\vs2019\VC\Tools\MSVC\14.29.30133\include\xloctime
; Line 180
	mov	QWORD PTR [rdi+32], rcx
; Line 186
	add	rsp, 80					; 00000050H
	pop	rdi
	ret	0
$LN19@Getvals:
; File C:\myPrograms\vs2019\VC\Tools\MSVC\14.29.30133\include\xlocnum
; Line 96
	call	?_Xbad_alloc@std@@YAXXZ			; std::_Xbad_alloc
	int	3
$LN17@Getvals:
??$_Getvals@_W@?$time_get@DV?$istreambuf_iterator@DU?$char_traits@D@std@@@std@@@std@@IEAAX_WAEBV_Locinfo@1@@Z ENDP ; std::time_get<char,std::istreambuf_iterator<char,std::char_traits<char> > >::_Getvals<wchar_t>
_TEXT	ENDS
; Function compile flags: /Ogtpy
;	COMDAT ??1Sieve@@QEAA@XZ
_TEXT	SEGMENT
this$ = 48
??1Sieve@@QEAA@XZ PROC					; Sieve::~Sieve, COMDAT
$LN8:
	sub	rsp, 40					; 00000028H
	add	rcx, 16
; File D:\myProjects\projects.cpp\sieve\headers\tBitArray.h
; Line 32
	call	?empty@tBitArray@@QEAAXXZ		; tBitArray::empty
	npad	1
	add	rsp, 40					; 00000028H
	ret	0
??1Sieve@@QEAA@XZ ENDP					; Sieve::~Sieve
_TEXT	ENDS
; Function compile flags: /Ogtpy
;	COMDAT ?dec@std@@YAAEAVios_base@1@AEAV21@@Z
_TEXT	SEGMENT
_Iosbase$ = 8
?dec@std@@YAAEAVios_base@1@AEAV21@@Z PROC		; std::dec, COMDAT
; File C:\myPrograms\vs2019\VC\Tools\MSVC\14.29.30133\include\ios
; File C:\myPrograms\vs2019\VC\Tools\MSVC\14.29.30133\include\xiosbase
; Line 344
	and	DWORD PTR [rcx+24], -3073		; fffffffffffff3ffH
; File C:\myPrograms\vs2019\VC\Tools\MSVC\14.29.30133\include\ios
; Line 193
	mov	rax, rcx
; File C:\myPrograms\vs2019\VC\Tools\MSVC\14.29.30133\include\xiosbase
; Line 344
	or	DWORD PTR [rcx+24], 512			; 00000200H
; File C:\myPrograms\vs2019\VC\Tools\MSVC\14.29.30133\include\ios
; Line 194
	ret	0
?dec@std@@YAAEAVios_base@1@AEAV21@@Z ENDP		; std::dec
_TEXT	ENDS
; Function compile flags: /Ogtpy
;	COMDAT ?_Maklocwcs@std@@YAPEA_WPEB_W@Z
_TEXT	SEGMENT
_Ptr$ = 48
?_Maklocwcs@std@@YAPEA_WPEB_W@Z PROC			; std::_Maklocwcs, COMDAT
; File C:\myPrograms\vs2019\VC\Tools\MSVC\14.29.30133\include\xlocnum
; Line 90
$LN10:
	mov	QWORD PTR [rsp+8], rbx
	mov	QWORD PTR [rsp+16], rsi
	push	rdi
	sub	rsp, 32					; 00000020H
	mov	rdi, rcx
; Line 91
	mov	rbx, -1
	npad	7
$LL6@Maklocwcs:
	inc	rbx
	cmp	WORD PTR [rcx+rbx*2], 0
	jne	SHORT $LL6@Maklocwcs
	inc	rbx
; Line 93
	mov	edx, 2
	mov	rcx, rbx
	call	QWORD PTR __imp_calloc
	mov	rsi, rax
; Line 95
	test	rax, rax
	je	SHORT $LN9@Maklocwcs
; File C:\Program Files (x86)\Windows Kits\10\Include\10.0.19041.0\ucrt\wchar.h
; Line 236
	lea	r8, QWORD PTR [rbx+rbx]
	mov	rdx, rdi
	mov	rcx, rax
	call	memcpy
; File C:\myPrograms\vs2019\VC\Tools\MSVC\14.29.30133\include\xlocnum
; Line 101
	mov	rbx, QWORD PTR [rsp+48]
	mov	rax, rsi
	mov	rsi, QWORD PTR [rsp+56]
	add	rsp, 32					; 00000020H
	pop	rdi
	ret	0
$LN9@Maklocwcs:
; Line 96
	call	?_Xbad_alloc@std@@YAXXZ			; std::_Xbad_alloc
	int	3
$LN7@Maklocwcs:
?_Maklocwcs@std@@YAPEA_WPEB_W@Z ENDP			; std::_Maklocwcs
_TEXT	ENDS
; Function compile flags: /Ogtpy
;	COMDAT ?assign@?$basic_string@DU?$char_traits@D@std@@V?$allocator@D@2@@std@@QEAAAEAV12@QEBD_K@Z
_TEXT	SEGMENT
this$ = 64
_Ptr$ = 72
_Count$ = 80
?assign@?$basic_string@DU?$char_traits@D@std@@V?$allocator@D@2@@std@@QEAAAEAV12@QEBD_K@Z PROC ; std::basic_string<char,std::char_traits<char>,std::allocator<char> >::assign, COMDAT
; File C:\myPrograms\vs2019\VC\Tools\MSVC\14.29.30133\include\xstring
; Line 3244
$LN79:
	mov	QWORD PTR [rsp+16], rbx
	mov	QWORD PTR [rsp+24], rbp
	push	rsi
	push	rdi
	push	r15
	sub	rsp, 32					; 00000020H
; Line 3246
	mov	rbp, QWORD PTR [rcx+24]
	mov	rsi, r8
	mov	r15, rdx
	mov	rbx, rcx
	cmp	r8, rbp
	ja	SHORT $LN2@assign
; Line 2296
	mov	rdi, rcx
; Line 2319
	cmp	rbp, 16
; Line 2297
	jb	SHORT $LN5@assign
; Line 2298
	mov	rdi, QWORD PTR [rcx]
$LN5@assign:
; Line 3248
	mov	QWORD PTR [rcx+16], rsi
; Line 122
	mov	rcx, rdi
	call	memmove
; Line 3250
	mov	BYTE PTR [rdi+rsi], 0
; Line 3251
	jmp	$LN73@assign
$LN2@assign:
; Line 4508
	mov	rdi, 9223372036854775807		; 7fffffffffffffffH
	cmp	rsi, rdi
	ja	$LN76@assign
; Line 4488
	mov	rcx, rsi
	mov	QWORD PTR [rsp+64], r14
	or	rcx, 15
	cmp	rcx, rdi
; Line 4489
	ja	SHORT $LN74@assign
; Line 4493
	mov	rdx, rbp
	mov	rax, rdi
	shr	rdx, 1
	sub	rax, rdx
	cmp	rbp, rax
	ja	SHORT $LN74@assign
; Line 4497
	lea	rax, QWORD PTR [rdx+rbp]
; File C:\myPrograms\vs2019\VC\Tools\MSVC\14.29.30133\include\utility
; Line 44
	mov	rdi, rcx
	cmp	rcx, rax
	cmovb	rdi, rax
; File C:\myPrograms\vs2019\VC\Tools\MSVC\14.29.30133\include\xstring
; Line 4515
	lea	rax, QWORD PTR [rdi+1]
; File C:\myPrograms\vs2019\VC\Tools\MSVC\14.29.30133\include\xmemory
; Line 237
	cmp	rax, 4096				; 00001000H
	jb	SHORT $LN27@assign
; Line 136
	lea	rcx, QWORD PTR [rax+39]
; Line 137
	cmp	rcx, rax
	jbe	$LN77@assign
	jmp	SHORT $LN37@assign
$LN74@assign:
; Line 85
	mov	rcx, -9223372036854775769		; 8000000000000027H
$LN37@assign:
	call	??2@YAPEAX_K@Z				; operator new
; Line 142
	test	rax, rax
	je	$LN63@assign
; Line 143
	lea	r14, QWORD PTR [rax+39]
	and	r14, -32				; ffffffffffffffe0H
; Line 144
	mov	QWORD PTR [r14-8], rax
; Line 238
	jmp	SHORT $LN26@assign
$LN27@assign:
; Line 243
	test	rax, rax
	je	SHORT $LN28@assign
; Line 85
	mov	rcx, rax
	call	??2@YAPEAX_K@Z				; operator new
	mov	r14, rax
; Line 244
	jmp	SHORT $LN26@assign
$LN28@assign:
; Line 247
	xor	r14d, r14d
$LN26@assign:
; File C:\myPrograms\vs2019\VC\Tools\MSVC\14.29.30133\include\xstring
; Line 65
	mov	r8, rsi
; Line 4523
	mov	QWORD PTR [rbx+16], rsi
; Line 65
	mov	rdx, r15
; Line 4524
	mov	QWORD PTR [rbx+24], rdi
; Line 65
	mov	rcx, r14
	call	memcpy
; Line 3258
	mov	BYTE PTR [r14+rsi], 0
; Line 4526
	cmp	rbp, 16
	jb	SHORT $LN13@assign
; File C:\myPrograms\vs2019\VC\Tools\MSVC\14.29.30133\include\xmemory
; Line 835
	mov	rcx, QWORD PTR [rbx]
; File C:\myPrograms\vs2019\VC\Tools\MSVC\14.29.30133\include\xstring
; Line 4527
	lea	rdx, QWORD PTR [rbp+1]
; File C:\myPrograms\vs2019\VC\Tools\MSVC\14.29.30133\include\xmemory
; Line 260
	cmp	rdx, 4096				; 00001000H
	jb	SHORT $LN66@assign
; Line 158
	mov	r8, QWORD PTR [rcx-8]
	add	rdx, 39					; 00000027H
; Line 171
	sub	rcx, r8
; Line 172
	lea	rax, QWORD PTR [rcx-8]
	cmp	rax, 31
	ja	SHORT $LN63@assign
; Line 173
	mov	rcx, r8
$LN66@assign:
; Line 264
	call	??3@YAXPEAX_K@Z				; operator delete
$LN13@assign:
; File C:\myPrograms\vs2019\VC\Tools\MSVC\14.29.30133\include\xstring
; Line 3254
	mov	QWORD PTR [rbx], r14
	mov	r14, QWORD PTR [rsp+64]
$LN73@assign:
; Line 3261
	mov	rbp, QWORD PTR [rsp+80]
	mov	rax, rbx
	mov	rbx, QWORD PTR [rsp+72]
	add	rsp, 32					; 00000020H
	pop	r15
	pop	rdi
	pop	rsi
	ret	0
$LN63@assign:
; File C:\myPrograms\vs2019\VC\Tools\MSVC\14.29.30133\include\xmemory
; Line 172
	call	QWORD PTR __imp__invalid_parameter_noinfo_noreturn
	int	3
$LN76@assign:
; File C:\myPrograms\vs2019\VC\Tools\MSVC\14.29.30133\include\xstring
; Line 4509
	call	?_Xlen_string@std@@YAXXZ		; std::_Xlen_string
	int	3
$LN77@assign:
; File C:\myPrograms\vs2019\VC\Tools\MSVC\14.29.30133\include\xmemory
; Line 138
	call	?_Throw_bad_array_new_length@std@@YAXXZ	; std::_Throw_bad_array_new_length
	int	3
$LN72@assign:
?assign@?$basic_string@DU?$char_traits@D@std@@V?$allocator@D@2@@std@@QEAAAEAV12@QEBD_K@Z ENDP ; std::basic_string<char,std::char_traits<char>,std::allocator<char> >::assign
_TEXT	ENDS
; Function compile flags: /Ogtpy
;	COMDAT ??1?$basic_string@DU?$char_traits@D@std@@V?$allocator@D@2@@std@@QEAA@XZ
_TEXT	SEGMENT
this$ = 48
??1?$basic_string@DU?$char_traits@D@std@@V?$allocator@D@2@@std@@QEAA@XZ PROC ; std::basic_string<char,std::char_traits<char>,std::allocator<char> >::~basic_string<char,std::char_traits<char>,std::allocator<char> >, COMDAT
; File C:\myPrograms\vs2019\VC\Tools\MSVC\14.29.30133\include\xstring
; Line 3002
$LN30:
	push	rbx
	sub	rsp, 32					; 00000020H
; Line 2319
	mov	rdx, QWORD PTR [rcx+24]
; Line 3002
	mov	rbx, rcx
; Line 2319
	cmp	rdx, 16
; Line 4618
	jb	SHORT $LN12@basic_stri
; File C:\myPrograms\vs2019\VC\Tools\MSVC\14.29.30133\include\xmemory
; Line 835
	mov	rcx, QWORD PTR [rcx]
; File C:\myPrograms\vs2019\VC\Tools\MSVC\14.29.30133\include\xstring
; Line 4622
	inc	rdx
; File C:\myPrograms\vs2019\VC\Tools\MSVC\14.29.30133\include\xmemory
; Line 260
	cmp	rdx, 4096				; 00001000H
	jb	SHORT $LN22@basic_stri
; Line 158
	mov	r8, QWORD PTR [rcx-8]
	add	rdx, 39					; 00000027H
; Line 171
	sub	rcx, r8
; Line 172
	lea	rax, QWORD PTR [rcx-8]
	cmp	rax, 31
	ja	SHORT $LN19@basic_stri
; Line 173
	mov	rcx, r8
$LN22@basic_stri:
; Line 264
	call	??3@YAXPEAX_K@Z				; operator delete
$LN12@basic_stri:
; File C:\myPrograms\vs2019\VC\Tools\MSVC\14.29.30133\include\xstring
; Line 4633
	mov	QWORD PTR [rbx+16], 0
; Line 4634
	mov	QWORD PTR [rbx+24], 15
; Line 4636
	mov	BYTE PTR [rbx], 0
; Line 3010
	add	rsp, 32					; 00000020H
	pop	rbx
	ret	0
$LN19@basic_stri:
; File C:\myPrograms\vs2019\VC\Tools\MSVC\14.29.30133\include\xmemory
; Line 172
	call	QWORD PTR __imp__invalid_parameter_noinfo_noreturn
	int	3
$LN27@basic_stri:
??1?$basic_string@DU?$char_traits@D@std@@V?$allocator@D@2@@std@@QEAA@XZ ENDP ; std::basic_string<char,std::char_traits<char>,std::allocator<char> >::~basic_string<char,std::char_traits<char>,std::allocator<char> >
_TEXT	ENDS
; Function compile flags: /Ogtpy
;	COMDAT ?_Xlen_string@std@@YAXXZ
_TEXT	SEGMENT
?_Xlen_string@std@@YAXXZ PROC				; std::_Xlen_string, COMDAT
; File C:\myPrograms\vs2019\VC\Tools\MSVC\14.29.30133\include\xstring
; Line 2373
$LN4:
	sub	rsp, 40					; 00000028H
; Line 2374
	lea	rcx, OFFSET FLAT:??_C@_0BA@JFNIOLAK@string?5too?5long@
	call	?_Xlength_error@std@@YAXPEBD@Z		; std::_Xlength_error
	int	3
$LN3@Xlen_strin:
?_Xlen_string@std@@YAXXZ ENDP				; std::_Xlen_string
_TEXT	ENDS
; Function compile flags: /Ogtpy
;	COMDAT ?_Throw_bad_array_new_length@std@@YAXXZ
_TEXT	SEGMENT
$T1 = 32
?_Throw_bad_array_new_length@std@@YAXXZ PROC		; std::_Throw_bad_array_new_length, COMDAT
; File C:\myPrograms\vs2019\VC\Tools\MSVC\14.29.30133\include\exception
; Line 320
$LN4:
	sub	rsp, 72					; 00000048H
; Line 321
	lea	rcx, QWORD PTR $T1[rsp]
	call	??0bad_array_new_length@std@@QEAA@XZ	; std::bad_array_new_length::bad_array_new_length
	lea	rdx, OFFSET FLAT:_TI3?AVbad_array_new_length@std@@
	lea	rcx, QWORD PTR $T1[rsp]
	call	_CxxThrowException
	int	3
$LN3@Throw_bad_:
?_Throw_bad_array_new_length@std@@YAXXZ ENDP		; std::_Throw_bad_array_new_length
_TEXT	ENDS
; Function compile flags: /Ogtpy
;	COMDAT ??_Gbad_array_new_length@std@@UEAAPEAXI@Z
_TEXT	SEGMENT
this$ = 48
__flags$ = 56
??_Gbad_array_new_length@std@@UEAAPEAXI@Z PROC		; std::bad_array_new_length::`scalar deleting destructor', COMDAT
$LN15:
	mov	QWORD PTR [rsp+8], rbx
	push	rdi
	sub	rsp, 32					; 00000020H
; File C:\myPrograms\vs2019\VC\Tools\MSVC\14.29.30133\include\vcruntime_exception.h
; Line 89
	lea	rax, OFFSET FLAT:??_7exception@std@@6B@
	mov	rdi, rcx
	mov	QWORD PTR [rcx], rax
	mov	ebx, edx
; Line 90
	add	rcx, 8
	call	__std_exception_destroy
	test	bl, 1
	je	SHORT $LN12@scalar
	mov	edx, 24
	mov	rcx, rdi
	call	??3@YAXPEAX_K@Z				; operator delete
$LN12@scalar:
	mov	rbx, QWORD PTR [rsp+48]
	mov	rax, rdi
	add	rsp, 32					; 00000020H
	pop	rdi
	ret	0
??_Gbad_array_new_length@std@@UEAAPEAXI@Z ENDP		; std::bad_array_new_length::`scalar deleting destructor'
_TEXT	ENDS
; Function compile flags: /Ogtpy
;	COMDAT ??0bad_array_new_length@std@@QEAA@AEBV01@@Z
_TEXT	SEGMENT
this$ = 48
__that$ = 56
??0bad_array_new_length@std@@QEAA@AEBV01@@Z PROC	; std::bad_array_new_length::bad_array_new_length, COMDAT
$LN10:
	push	rbx
	sub	rsp, 32					; 00000020H
	mov	rbx, rcx
	mov	rax, rdx
; File C:\myPrograms\vs2019\VC\Tools\MSVC\14.29.30133\include\vcruntime_exception.h
; Line 72
	lea	rcx, OFFSET FLAT:??_7exception@std@@6B@
	xorps	xmm0, xmm0
; Line 71
	lea	rdx, QWORD PTR [rbx+8]
; Line 72
	mov	QWORD PTR [rbx], rcx
; Line 73
	lea	rcx, QWORD PTR [rax+8]
	movups	XMMWORD PTR [rdx], xmm0
	call	__std_exception_copy
	lea	rax, OFFSET FLAT:??_7bad_array_new_length@std@@6B@
	mov	QWORD PTR [rbx], rax
	mov	rax, rbx
	add	rsp, 32					; 00000020H
	pop	rbx
	ret	0
??0bad_array_new_length@std@@QEAA@AEBV01@@Z ENDP	; std::bad_array_new_length::bad_array_new_length
_TEXT	ENDS
; Function compile flags: /Ogtpy
;	COMDAT ??1bad_array_new_length@std@@UEAA@XZ
_TEXT	SEGMENT
this$ = 8
??1bad_array_new_length@std@@UEAA@XZ PROC		; std::bad_array_new_length::~bad_array_new_length, COMDAT
; File C:\myPrograms\vs2019\VC\Tools\MSVC\14.29.30133\include\vcruntime_exception.h
; Line 89
	lea	rax, OFFSET FLAT:??_7exception@std@@6B@
	mov	QWORD PTR [rcx], rax
; Line 90
	add	rcx, 8
	jmp	__std_exception_destroy
??1bad_array_new_length@std@@UEAA@XZ ENDP		; std::bad_array_new_length::~bad_array_new_length
_TEXT	ENDS
; Function compile flags: /Ogtpy
;	COMDAT ??0bad_array_new_length@std@@QEAA@XZ
_TEXT	SEGMENT
this$ = 8
??0bad_array_new_length@std@@QEAA@XZ PROC		; std::bad_array_new_length::bad_array_new_length, COMDAT
; File C:\myPrograms\vs2019\VC\Tools\MSVC\14.29.30133\include\vcruntime_exception.h
; Line 67
	lea	rax, OFFSET FLAT:??_C@_0BF@KINCDENJ@bad?5array?5new?5length@
	mov	QWORD PTR [rcx+16], 0
	mov	QWORD PTR [rcx+8], rax
; Line 141
	lea	rax, OFFSET FLAT:??_7bad_array_new_length@std@@6B@
	mov	QWORD PTR [rcx], rax
; Line 142
	mov	rax, rcx
	ret	0
??0bad_array_new_length@std@@QEAA@XZ ENDP		; std::bad_array_new_length::bad_array_new_length
_TEXT	ENDS
; Function compile flags: /Ogtpy
;	COMDAT ??_Gbad_alloc@std@@UEAAPEAXI@Z
_TEXT	SEGMENT
this$ = 48
__flags$ = 56
??_Gbad_alloc@std@@UEAAPEAXI@Z PROC			; std::bad_alloc::`scalar deleting destructor', COMDAT
$LN12:
	mov	QWORD PTR [rsp+8], rbx
	push	rdi
	sub	rsp, 32					; 00000020H
; File C:\myPrograms\vs2019\VC\Tools\MSVC\14.29.30133\include\vcruntime_exception.h
; Line 89
	lea	rax, OFFSET FLAT:??_7exception@std@@6B@
	mov	rdi, rcx
	mov	QWORD PTR [rcx], rax
	mov	ebx, edx
; Line 90
	add	rcx, 8
	call	__std_exception_destroy
	test	bl, 1
	je	SHORT $LN9@scalar
	mov	edx, 24
	mov	rcx, rdi
	call	??3@YAXPEAX_K@Z				; operator delete
$LN9@scalar:
	mov	rbx, QWORD PTR [rsp+48]
	mov	rax, rdi
	add	rsp, 32					; 00000020H
	pop	rdi
	ret	0
??_Gbad_alloc@std@@UEAAPEAXI@Z ENDP			; std::bad_alloc::`scalar deleting destructor'
_TEXT	ENDS
; Function compile flags: /Ogtpy
;	COMDAT ??0bad_alloc@std@@QEAA@AEBV01@@Z
_TEXT	SEGMENT
this$ = 48
__that$ = 56
??0bad_alloc@std@@QEAA@AEBV01@@Z PROC			; std::bad_alloc::bad_alloc, COMDAT
$LN7:
	push	rbx
	sub	rsp, 32					; 00000020H
	mov	rbx, rcx
	mov	rax, rdx
; File C:\myPrograms\vs2019\VC\Tools\MSVC\14.29.30133\include\vcruntime_exception.h
; Line 72
	lea	rcx, OFFSET FLAT:??_7exception@std@@6B@
	xorps	xmm0, xmm0
; Line 71
	lea	rdx, QWORD PTR [rbx+8]
; Line 72
	mov	QWORD PTR [rbx], rcx
; Line 73
	lea	rcx, QWORD PTR [rax+8]
	movups	XMMWORD PTR [rdx], xmm0
	call	__std_exception_copy
	lea	rax, OFFSET FLAT:??_7bad_alloc@std@@6B@
	mov	QWORD PTR [rbx], rax
	mov	rax, rbx
	add	rsp, 32					; 00000020H
	pop	rbx
	ret	0
??0bad_alloc@std@@QEAA@AEBV01@@Z ENDP			; std::bad_alloc::bad_alloc
_TEXT	ENDS
; Function compile flags: /Ogtpy
;	COMDAT ??_Gexception@std@@UEAAPEAXI@Z
_TEXT	SEGMENT
this$ = 48
__flags$ = 56
??_Gexception@std@@UEAAPEAXI@Z PROC			; std::exception::`scalar deleting destructor', COMDAT
$LN9:
	mov	QWORD PTR [rsp+8], rbx
	push	rdi
	sub	rsp, 32					; 00000020H
; File C:\myPrograms\vs2019\VC\Tools\MSVC\14.29.30133\include\vcruntime_exception.h
; Line 89
	lea	rax, OFFSET FLAT:??_7exception@std@@6B@
	mov	rdi, rcx
	mov	QWORD PTR [rcx], rax
	mov	ebx, edx
; Line 90
	add	rcx, 8
	call	__std_exception_destroy
	test	bl, 1
	je	SHORT $LN6@scalar
	mov	edx, 24
	mov	rcx, rdi
	call	??3@YAXPEAX_K@Z				; operator delete
$LN6@scalar:
	mov	rbx, QWORD PTR [rsp+48]
	mov	rax, rdi
	add	rsp, 32					; 00000020H
	pop	rdi
	ret	0
??_Gexception@std@@UEAAPEAXI@Z ENDP			; std::exception::`scalar deleting destructor'
_TEXT	ENDS
; Function compile flags: /Ogtpy
;	COMDAT ?what@exception@std@@UEBAPEBDXZ
_TEXT	SEGMENT
this$ = 8
?what@exception@std@@UEBAPEBDXZ PROC			; std::exception::what, COMDAT
; File C:\myPrograms\vs2019\VC\Tools\MSVC\14.29.30133\include\vcruntime_exception.h
; Line 95
	mov	rdx, QWORD PTR [rcx+8]
	lea	rax, OFFSET FLAT:??_C@_0BC@EOODALEL@Unknown?5exception@
	test	rdx, rdx
	cmovne	rax, rdx
; Line 96
	ret	0
?what@exception@std@@UEBAPEBDXZ ENDP			; std::exception::what
_TEXT	ENDS
; Function compile flags: /Ogtpy
;	COMDAT ??1exception@std@@UEAA@XZ
_TEXT	SEGMENT
this$ = 8
??1exception@std@@UEAA@XZ PROC				; std::exception::~exception, COMDAT
; File C:\myPrograms\vs2019\VC\Tools\MSVC\14.29.30133\include\vcruntime_exception.h
; Line 89
	lea	rax, OFFSET FLAT:??_7exception@std@@6B@
	mov	QWORD PTR [rcx], rax
; Line 90
	add	rcx, 8
	jmp	__std_exception_destroy
??1exception@std@@UEAA@XZ ENDP				; std::exception::~exception
_TEXT	ENDS
; Function compile flags: /Ogtpy
;	COMDAT ??0exception@std@@QEAA@AEBV01@@Z
_TEXT	SEGMENT
this$ = 48
_Other$ = 56
??0exception@std@@QEAA@AEBV01@@Z PROC			; std::exception::exception, COMDAT
; File C:\myPrograms\vs2019\VC\Tools\MSVC\14.29.30133\include\vcruntime_exception.h
; Line 72
$LN5:
	push	rbx
	sub	rsp, 32					; 00000020H
	mov	rbx, rcx
	mov	rax, rdx
	lea	rcx, OFFSET FLAT:??_7exception@std@@6B@
	xorps	xmm0, xmm0
	lea	rdx, QWORD PTR [rbx+8]
	mov	QWORD PTR [rbx], rcx
; Line 73
	lea	rcx, QWORD PTR [rax+8]
	movups	XMMWORD PTR [rdx], xmm0
	call	__std_exception_copy
; Line 74
	mov	rax, rbx
	add	rsp, 32					; 00000020H
	pop	rbx
	ret	0
??0exception@std@@QEAA@AEBV01@@Z ENDP			; std::exception::exception
_TEXT	ENDS
END
